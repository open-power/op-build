## openpower/configs/p10ebmc_defconfig
```kconfig
BR2_powerpc64le=y
BR2_powerpc_power8=y
BR2_PACKAGE_HOST_LINUX_HEADERS_CUSTOM_5_10=y
BR2_BINUTILS_VERSION_2_32_X=y
BR2_BINUTILS_EXTRA_CONFIG_OPTIONS="--enable-targets=powerpc64-linux"
BR2_GCC_VERSION_8_X=y
BR2_EXTRA_GCC_CONFIG_OPTIONS="--enable-targets=powerpc64-linux --disable-libsanitizer"
BR2_TOOLCHAIN_BUILDROOT_CXX=y
BR2_TARGET_GENERIC_HOSTNAME="skiroot"
BR2_ROOTFS_DEVICE_CREATION_DYNAMIC_EUDEV=y
BR2_ROOTFS_DEVICE_TABLE="../openpower/device_table.txt"
BR2_TARGET_GENERIC_GETTY_PORT="hvc0"
BR2_ENABLE_LOCALE_WHITELIST="C de en es fr it ja ko pt_BR ru zh_CN zh_TW"
BR2_GENERATE_LOCALE="en_US.UTF-8 de_DE.UTF-8 es_ES.UTF-8 fr_FR.UTF-8 it_IT.UTF-8 ja_JP.UTF-8 ko_KR.UTF-8 pt_BR.UTF-8 ru_RU.UTF-8 zh_CN.UTF-8 zh_TW.UTF-8"
BR2_SYSTEM_ENABLE_NLS=y
BR2_ROOTFS_USERS_TABLES="$(BR2_EXTERNAL_OP_BUILD_PATH)/configs/users-table"
BR2_ROOTFS_OVERLAY="../openpower/overlay"
BR2_ROOTFS_POST_BUILD_SCRIPT="../openpower/scripts/fixup-target-var ../openpower/scripts/firmware-whitelist"
BR2_LINUX_KERNEL=y
BR2_LINUX_KERNEL_CUSTOM_VERSION=y
BR2_LINUX_KERNEL_CUSTOM_VERSION_VALUE="5.10.50"
BR2_LINUX_KERNEL_PATCH="$(BR2_EXTERNAL_OP_BUILD_PATH)/linux"
BR2_LINUX_KERNEL_USE_CUSTOM_CONFIG=y
BR2_LINUX_KERNEL_CUSTOM_CONFIG_FILE="$(BR2_EXTERNAL_OP_BUILD_PATH)/configs/linux/skiroot_defconfig"
BR2_LINUX_KERNEL_ZIMAGE_EPAPR=y
BR2_LINUX_KERNEL_XZ=y
BR2_LINUX_KERNEL_NEEDS_HOST_OPENSSL=y
BR2_PACKAGE_BUSYBOX_CONFIG_FRAGMENT_FILES="$(BR2_EXTERNAL_OP_BUILD_PATH)/configs/busybox.fragment"
BR2_PACKAGE_BUSYBOX_SHOW_OTHERS=y
BR2_PACKAGE_LINUX_FIRMWARE=y
BR2_PACKAGE_LINUX_FIRMWARE_BNX2X=y
BR2_PACKAGE_LINUX_FIRMWARE_CXGB4_T4=y
BR2_PACKAGE_CRYPTSETUP=y
BR2_PACKAGE_IPMITOOL=y
BR2_PACKAGE_IPMITOOL_USB=y
BR2_PACKAGE_MDADM=y
BR2_PACKAGE_PCIUTILS=y
BR2_PACKAGE_NCURSES_WCHAR=y
BR2_PACKAGE_DROPBEAR=y
# BR2_PACKAGE_DROPBEAR_SERVER is not set
BR2_PACKAGE_ETHTOOL=y
BR2_PACKAGE_LRZSZ=y
BR2_PACKAGE_NETCAT=y
BR2_PACKAGE_RSYNC=y
BR2_PACKAGE_SUDO=y
BR2_PACKAGE_UTIL_LINUX_AGETTY=y
BR2_TARGET_ROOTFS_CPIO_XZ=y
BR2_OPENPOWER_PLATFORM=y
BR2_OPENPOWER_POWER10=y
BR2_HOSTBOOT_P10_CONFIG_FILE="p10ebmc.config"
# BR2_PACKAGE_MACHINE_XML is not set
BR2_OPENPOWER_MACHINE_XML_CUSTOM_GIT=y
BR2_RAINIER_2U_XML_CUSTOM_GIT=y
# TODO: Update the level when the XML is synced to public
#BR2_RAINIER_2U_XML_CUSTOM_GIT_VALUE="git@github.com:open-power/rainier-xml.git"
#BR2_RAINIER_2U_XML_VERSION="d5127bbed1a181d39cbc24ea33ea7b6df15baa4e"
BR2_RAINIER_2U_XML_CUSTOM_GIT_VALUE="git@github.ibm.com:openbmc/rainier-xml.git"
BR2_RAINIER_2U_XML_VERSION="d5127bbed1a181d39cbc24ea33ea7b6df15baa4e"
BR2_RAINIER_2U_XML_SYSTEM_FILENAME="Rainier-2U-MRW_hb.system.xml"
BR2_RAINIER_2U_XML_TARGETING_FILENAME="Rainier-2U-MRW_hb.mrw.xml"
BR2_RAINIER_4U_XML_CUSTOM_GIT=y
# TODO: Update the level when the XML is synced to public
#BR2_RAINIER_4U_XML_CUSTOM_GIT_VALUE="git@github.com:open-power/rainier-xml.git"
#BR2_RAINIER_4U_XML_VERSION="d5127bbed1a181d39cbc24ea33ea7b6df15baa4e"
BR2_RAINIER_4U_XML_CUSTOM_GIT_VALUE="git@github.ibm.com:openbmc/rainier-xml.git"
BR2_RAINIER_4U_XML_VERSION="d5127bbed1a181d39cbc24ea33ea7b6df15baa4e"
BR2_RAINIER_4U_XML_SYSTEM_FILENAME="Rainier-4U-MRW_hb.system.xml"
BR2_RAINIER_4U_XML_TARGETING_FILENAME="Rainier-4U-MRW_hb.mrw.xml"
BR2_PACKAGE_EVEREST_XML=y
BR2_EVEREST_XML_CUSTOM_GIT=y
# TODO: Update the level when the XML is synced to public
#BR2_EVEREST_XML_CUSTOM_GIT_VALUE="git@github.com:open-power/everest-xml.git"
#BR2_EVEREST_XML_VERSION="f3461debbbde70d33d5264411ee37abde9be6815"
BR2_EVEREST_XML_CUSTOM_GIT_VALUE="git@github.ibm.com:openbmc/everest-xml.git"
BR2_EVEREST_XML_VERSION="1f8b518b67f4dd8306d70a35699203efe8215a70"
BR2_EVEREST_XML_SYSTEM_FILENAME="Everest-MRW_hb.system.xml"
BR2_EVEREST_XML_TARGETING_FILENAME="Everest-MRW_hb.mrw.xml"
BR2_PACKAGE_OPENPOWER_PNOR_P10=y
BR2_OPENPOWER_P10_PNOR_XML_LAYOUT_FILENAME="defaultPnorLayout_64.xml"
BR2_OPENPOWER_PNOR_P10_LEGACY_PNOR_TARGET="rainier"
BR2_OPENPOWER_P10_XMLS="rainier-2u-xml rainier-4u-xml everest-xml"
BR2_HOSTBOOT_P10_BINARY_SBE_FILENAME="p10_sbe.img.ecc"
BR2_HOSTBOOT_P10_BINARY_SBEC_FILENAME="centaur_sbec_pad.img.ecc"
BR2_HOSTBOOT_P10_BINARY_WINK_FILENAME="p10.ref_image.hdr.bin.ecc"
BR2_IMA_CATALOG_P10_FILENAME="ima_catalog.bin"
BR2_PACKAGE_PETITBOOT=y
BR2_PACKAGE_PETITBOOT_MTD=y
# BR2_PACKAGE_CAPP_UCODE is not set
BR2_PACKAGE_LOADKEYS=y
BR2_IMA_CATALOG_DTS="POWER10"
BR2_PACKAGE_OCMB_EXPLORER_FW=y
BR2_PACKAGE_IBM_FW_PROPRIETARY_P10=y
BR2_OPENPOWER_SIGNED_SECURITY_VERSION="0"
```

## openpower/configs/p9_simics_defconfig
```kconfig
BR2_powerpc64le=y
BR2_powerpc_power8=y
BR2_BINUTILS_EXTRA_CONFIG_OPTIONS="--enable-targets=powerpc64-linux"
BR2_EXTRA_GCC_CONFIG_OPTIONS="--enable-targets=powerpc64-linux --disable-libsanitizer"
BR2_LINUX_KERNEL=y
BR2_LINUX_KERNEL_CUSTOM_VERSION=y
BR2_LINUX_KERNEL_CUSTOM_VERSION_VALUE="4.19.1"
BR2_LINUX_KERNEL_DEFCONFIG="ppc64le"
BR2_LINUX_KERNEL_VMLINUX=y
BR2_TARGET_ROOTFS_CPIO=y
# BR2_TARGET_ROOTFS_TAR is not set
BR2_OPENPOWER_PLATFORM=y
BR2_OPENPOWER_POWER9=y
# BR2_PACKAGE_HOST_OPENPOWER_FFS is not set
# BR2_PACKAGE_HOSTBOOT is not set
# BR2_PACKAGE_HOSTBOOT_BINARIES is not set
# BR2_PACKAGE_MACHINE_XML is not set
# BR2_OPENPOWER_MACHINE_XML_FILTER_UNWANTED_ATTRIBUTES is not set
# BR2_OPENPOWER_MACHINE_XML_OPPOWERVM_ATTRIBUTES is not set
# BR2_OPENPOWER_MACHINE_XML_TARGET_TYPES_OPENPOWER_XML is not set
# BR2_PACKAGE_OPENPOWER_PNOR is not set
# BR2_TARGET_SKIBOOT_XZ is not set
# BR2_PACKAGE_HCODE is not set
# BR2_PACKAGE_OCC is not set
# BR2_PACKAGE_CAPP_UCODE is not set
# BR2_PACKAGE_HOST_PPE42_BINUTILS is not set
# BR2_PACKAGE_HOST_PPE42_GCC is not set
# BR2_PACKAGE_IMA_CATALOG is not set
# BR2_PACKAGE_HOST_SB_SIGNING_UTILS is not set
BR2_PACKAGE_DEVICETREE=y
BR2_DEVICETREE_SOURCE="p9_simics.dts"
```

## openpower/configs/p9dsu_defconfig
```kconfig
BR2_powerpc64le=y
BR2_powerpc_power8=y
BR2_PACKAGE_HOST_LINUX_HEADERS_CUSTOM_5_4=y
BR2_BINUTILS_EXTRA_CONFIG_OPTIONS="--enable-targets=powerpc64-linux"
BR2_GCC_VERSION_6_X=y
BR2_EXTRA_GCC_CONFIG_OPTIONS="--enable-targets=powerpc64-linux --disable-libsanitizer"
BR2_TOOLCHAIN_BUILDROOT_CXX=y
BR2_TARGET_GENERIC_HOSTNAME="skiroot"
BR2_ROOTFS_DEVICE_CREATION_DYNAMIC_EUDEV=y
BR2_ROOTFS_DEVICE_TABLE="../openpower/device_table.txt"
BR2_TARGET_GENERIC_GETTY_PORT="hvc0"
BR2_ENABLE_LOCALE_WHITELIST="C de en es fr it ja ko pt_BR ru zh_CN zh_TW"
BR2_GENERATE_LOCALE="en_US.UTF-8 de_DE.UTF-8 es_ES.UTF-8 fr_FR.UTF-8 it_IT.UTF-8 ja_JP.UTF-8 ko_KR.UTF-8 pt_BR.UTF-8 ru_RU.UTF-8 zh_CN.UTF-8 zh_TW.UTF-8"
BR2_SYSTEM_ENABLE_NLS=y
BR2_ROOTFS_USERS_TABLES="$(BR2_EXTERNAL_OP_BUILD_PATH)/configs/users-table"
BR2_ROOTFS_OVERLAY="../openpower/overlay"
BR2_ROOTFS_POST_BUILD_SCRIPT="../openpower/scripts/fixup-target-var ../openpower/scripts/firmware-whitelist"
BR2_LINUX_KERNEL=y
BR2_LINUX_KERNEL_CUSTOM_VERSION=y
BR2_LINUX_KERNEL_CUSTOM_VERSION_VALUE="5.4.48"
BR2_LINUX_KERNEL_PATCH="$(BR2_EXTERNAL_OP_BUILD_PATH)/linux"
BR2_LINUX_KERNEL_USE_CUSTOM_CONFIG=y
BR2_LINUX_KERNEL_CUSTOM_CONFIG_FILE="$(BR2_EXTERNAL_OP_BUILD_PATH)/configs/linux/skiroot_defconfig"
BR2_LINUX_KERNEL_ZIMAGE_EPAPR=y
BR2_LINUX_KERNEL_XZ=y
BR2_LINUX_KERNEL_NEEDS_HOST_OPENSSL=y
BR2_PACKAGE_BUSYBOX_CONFIG_FRAGMENT_FILES="$(BR2_EXTERNAL_OP_BUILD_PATH)/configs/busybox.fragment"
BR2_PACKAGE_BUSYBOX_SHOW_OTHERS=y
BR2_PACKAGE_LINUX_FIRMWARE=y
BR2_PACKAGE_LINUX_FIRMWARE_BNX2X=y
BR2_PACKAGE_LINUX_FIRMWARE_CXGB4_T4=y
BR2_PACKAGE_LINUX_FIRMWARE_QLOGIC_2XXX=y
BR2_PACKAGE_CRYPTSETUP=y
BR2_PACKAGE_IPMITOOL=y
BR2_PACKAGE_IPMITOOL_USB=y
BR2_PACKAGE_MDADM=y
BR2_PACKAGE_PCIUTILS=y
BR2_PACKAGE_NCURSES_WCHAR=y
BR2_PACKAGE_DROPBEAR=y
# BR2_PACKAGE_DROPBEAR_SERVER is not set
BR2_PACKAGE_ETHTOOL=y
BR2_PACKAGE_LRZSZ=y
BR2_PACKAGE_NETCAT=y
BR2_PACKAGE_RSYNC=y
BR2_PACKAGE_SUDO=y
BR2_PACKAGE_UTIL_LINUX_AGETTY=y
BR2_TARGET_ROOTFS_CPIO_XZ=y
BR2_TARGET_ROOTFS_INITRAMFS=y
BR2_OPENPOWER_PLATFORM=y
BR2_OPENPOWER_POWER9=y
BR2_HOSTBOOT_CONFIG_FILE="p9dsu.config"
BR2_OPENPOWER_MACHINE_XML_GITHUB_PROJECT_VALUE="p9dsu-xml"
BR2_OPENPOWER_MACHINE_XML_VERSION="32ce616ef80f5cc3f128b3aa08fe50954a087888"
BR2_OPENPOWER_MACHINE_XML_FILENAME="p9dsu.xml"
BR2_OPENPOWER_SYSTEM_XML_FILENAME="P9DSU_hb.system.xml"
BR2_OPENPOWER_MRW_XML_FILENAME="P9DSU_hb.mrw.xml"
BR2_OPENPOWER_BIOS_XML_FILENAME="P9DSU_bios.xml"
BR2_OPENPOWER_PNOR_XML_LAYOUT_FILENAME="defaultPnorLayout_64.xml"
BR2_OPENPOWER_CONFIG_NAME="p9dsu"
BR2_OPENPOWER_PNOR_FILENAME="p9dsu.pnor"
BR2_HOSTBOOT_BINARY_SBE_FILENAME="nimbus_sbe.img.ecc"
BR2_HOSTBOOT_BINARY_SBEC_FILENAME="centaur_sbec_pad.img.ecc"
BR2_HOSTBOOT_BINARY_WINK_FILENAME="p9n.ref_image.hdr.bin.ecc"
BR2_IMA_CATALOG_FILENAME="ima_catalog.bin"
BR2_OPENPOWER_TARGETING_BIN_FILENAME="P9DSU_HB.targeting.bin"
BR2_OPENPOWER_TARGETING_ECC_FILENAME="P9DSU_HB.targeting.bin.ecc"
BR2_PACKAGE_PETITBOOT=y
BR2_PACKAGE_PETITBOOT_MTD=y
BR2_CAPP_UCODE_BIN_FILENAME="cappucode.bin"
BR2_PACKAGE_LOADKEYS=y
BR2_IMA_CATALOG_DTS="POWER9"
```

## openpower/configs/palmetto_defconfig
```kconfig
BR2_powerpc64=y
BR2_powerpc_power8=y
BR2_OPENPOWER_PLATFORM=y

BR2_OPENPOWER_CONFIG_NAME="palmetto"
BR2_HOSTBOOT_CONFIG_FILE="palmetto.config"

BR2_HOSTBOOT_BINARY_SBE_FILENAME="palmetto_sbe.img.ecc"
BR2_HOSTBOOT_BINARY_SBEC_FILENAME="palmetto_sbec_pad.img.ecc"

BR2_OPENPOWER_TARGETING_SYSTEM_XML_FILENAME="PALMETTO_hb.system.xml"
BR2_OPENPOWER_TARGETING_MRW_XML_FILENAME="PALMETTO_hb.mrw.xml"
BR2_OPENPOWER_TARGETING_BIN_FILENAME="PALMETTO_HB.targeting.bin"
BR2_OPENPOWER_TARGETING_ECC_FILENAME="PALMETTO_HB.targeting.bin.ecc"

BR2_OPENPOWER_PNOR_XML_LAYOUT_FILENAME="PalmettoPnorLayout.xml"
BR2_OPENPOWER_PNOR_FILENAME="palmetto.pnor"

# skiboot requirements
BR2_TARGET_SKIBOOT=y
BR2_TARGET_SKIBOOT_EMBED_PAYLOAD=y

# petitboot requirements
BR2_ENABLE_LOCALE_PURGE=y
BR2_ENABLE_LOCALE_WHITELIST="C en_US"
BR2_GENERATE_LOCALE="en_US.UTF-8"
BR2_ROOTFS_DEVICE_CREATION_DYNAMIC_EUDEV=y
BR2_TARGET_GENERIC_GETTY_PORT="hvc0"
BR2_ROOTFS_OVERLAY="overlay"
BR2_LINUX_KERNEL=y
BR2_LINUX_KERNEL_CUSTOM_GIT=y
BR2_LINUX_KERNEL_CUSTOM_REPO_URL="git://git.kernel.org/pub/scm/linux/kernel/git/paulus/powerkvm.git"
BR2_LINUX_KERNEL_CUSTOM_REPO_VERSION="71ca6744e118d6850bf47f58e872900f5f47b9ee"
BR2_LINUX_KERNEL_USE_DEFCONFIG=y
BR2_LINUX_KERNEL_DEFCONFIG="skiroot"
BR2_LINUX_KERNEL_ZIMAGE_EPAPR=y
BR2_PACKAGE_BUSYBOX_SHOW_OTHERS=y
BR2_PACKAGE_LINUX_FIRMWARE=y
BR2_PACKAGE_LINUX_FIRMWARE_BNX2X=y
BR2_PACKAGE_LINUX_FIRMWARE_CXGB4=y
BR2_PACKAGE_NCURSES_WCHAR=y
BR2_PACKAGE_DROPBEAR=y
# BR2_PACKAGE_DROPBEAR_SERVER is not set
BR2_PACKAGE_ETHTOOL=y
BR2_PACKAGE_NETCAT=y
BR2_PACKAGE_RSYNC=y
BR2_PACKAGE_PETITBOOT=y
BR2_TARGET_ROOTFS_CPIO_XZ=y
BR2_TARGET_ROOTFS_INITRAMFS=y
```

## openpower/configs/rainier_defconfig
```kconfig
BR2_powerpc64le=y
BR2_powerpc_power8=y
BR2_BINUTILS_EXTRA_CONFIG_OPTIONS="--enable-targets=powerpc64-linux"
BR2_GCC_VERSION_8_X=y
BR2_EXTRA_GCC_CONFIG_OPTIONS="--enable-targets=powerpc64-linux --disable-libsanitizer"
BR2_TOOLCHAIN_BUILDROOT_CXX=y
BR2_TARGET_GENERIC_HOSTNAME="skiroot"
BR2_ROOTFS_DEVICE_CREATION_DYNAMIC_EUDEV=y
BR2_ROOTFS_DEVICE_TABLE="../openpower/device_table.txt"
BR2_TARGET_GENERIC_GETTY_PORT="hvc0"
BR2_ENABLE_LOCALE_WHITELIST="C de en es fr it ja ko pt_BR ru zh_CN zh_TW"
BR2_GENERATE_LOCALE="en_US.UTF-8 de_DE.UTF-8 es_ES.UTF-8 fr_FR.UTF-8 it_IT.UTF-8 ja_JP.UTF-8 ko_KR.UTF-8 pt_BR.UTF-8 ru_RU.UTF-8 zh_CN.UTF-8 zh_TW.UTF-8"
BR2_SYSTEM_ENABLE_NLS=y
BR2_ROOTFS_USERS_TABLES="$(BR2_EXTERNAL_OP_BUILD_PATH)/configs/users-table"
BR2_ROOTFS_OVERLAY="../openpower/overlay"
BR2_ROOTFS_POST_BUILD_SCRIPT="../openpower/scripts/fixup-target-var ../openpower/scripts/firmware-whitelist"
BR2_LINUX_KERNEL=y
BR2_LINUX_KERNEL_CUSTOM_GIT=y
BR2_LINUX_KERNEL_CUSTOM_REPO_URL="git@github.ibm.com:p10/linux.git"
BR2_LINUX_KERNEL_CUSTOM_REPO_VERSION="f607d43b7d6e54f2610933ea2da9f9732237cb51"
BR2_LINUX_KERNEL_PATCH="$(BR2_EXTERNAL_OP_BUILD_PATH)/linux-p10"
BR2_LINUX_KERNEL_USE_CUSTOM_CONFIG=y
BR2_LINUX_KERNEL_CUSTOM_CONFIG_FILE="$(BR2_EXTERNAL_OP_BUILD_PATH)/configs/linux/skiroot_defconfig"
BR2_LINUX_KERNEL_ZIMAGE_EPAPR=y
BR2_LINUX_KERNEL_XZ=y
BR2_LINUX_KERNEL_NEEDS_HOST_OPENSSL=y
BR2_PACKAGE_BUSYBOX_CONFIG_FRAGMENT_FILES="$(BR2_EXTERNAL_OP_BUILD_PATH)/configs/busybox.fragment"
BR2_PACKAGE_BUSYBOX_SHOW_OTHERS=y
BR2_PACKAGE_LINUX_FIRMWARE=y
BR2_PACKAGE_LINUX_FIRMWARE_BNX2X=y
BR2_PACKAGE_LINUX_FIRMWARE_CXGB4_T4=y
BR2_PACKAGE_CRYPTSETUP=y
BR2_PACKAGE_IPMITOOL=y
BR2_PACKAGE_IPMITOOL_USB=y
BR2_PACKAGE_MDADM=y
BR2_PACKAGE_PCIUTILS=y
BR2_PACKAGE_NCURSES_WCHAR=y
BR2_PACKAGE_DROPBEAR=y
# BR2_PACKAGE_DROPBEAR_SERVER is not set
BR2_PACKAGE_ETHTOOL=y
BR2_PACKAGE_LRZSZ=y
BR2_PACKAGE_NETCAT=y
BR2_PACKAGE_RSYNC=y
BR2_PACKAGE_SUDO=y
BR2_PACKAGE_UTIL_LINUX_AGETTY=y
BR2_TARGET_ROOTFS_CPIO_XZ=y
BR2_TARGET_ROOTFS_INITRAMFS=y
BR2_OPENPOWER_PLATFORM=y
BR2_OPENPOWER_POWER10=y
BR2_HOSTBOOT_P10_CONFIG_FILE="rainier.config"
BR2_OPENPOWER_MACHINE_XML_CUSTOM_GIT=y
BR2_OPENPOWER_MACHINE_XML_CUSTOM_GIT_VALUE="git@github.ibm.com:openbmc/rainier-xml.git"
BR2_OPENPOWER_MACHINE_XML_VERSION="79e2a954e4aaea7b076e0b9b0253f105e960eb6e"
BR2_OPENPOWER_MACHINE_XML_FILENAME="Rainier-2U-MRW.xml"
BR2_OPENPOWER_SYSTEM_XML_FILENAME="RAINIER_hb.system.xml"
BR2_OPENPOWER_MRW_XML_FILENAME="RAINIER_hb.mrw.xml"
BR2_OPENPOWER_BIOS_XML_FILENAME="Rainier-2U-MRW_bios.xml"
BR2_OPENPOWER_PNOR_XML_LAYOUT_FILENAME="defaultPnorLayout_64.xml"
BR2_OPENPOWER_CONFIG_NAME="rainier"
BR2_OPENPOWER_PNOR_FILENAME="rainier.pnor"
BR2_HOSTBOOT_BINARY_SBE_FILENAME="p10_sbe.img.ecc"
BR2_HOSTBOOT_BINARY_SBEC_FILENAME="centaur_sbec_pad.img.ecc"
BR2_HOSTBOOT_BINARY_WINK_FILENAME="p10.ref_image.hdr.bin.ecc"
BR2_IMA_CATALOG_FILENAME="ima_catalog.bin"
BR2_OPENPOWER_TARGETING_BIN_FILENAME="RAINIER_HB.targeting.bin"
BR2_OPENPOWER_TARGETING_ECC_FILENAME="RAINIER_HB.targeting.bin.ecc"
BR2_BUILD_PNOR_SQUASHFS=y
BR2_OPENPOWER_MAKE_LIDS=y
BR2_PACKAGE_PETITBOOT=y
BR2_PACKAGE_PETITBOOT_MTD=y
BR2_CAPP_UCODE_BIN_FILENAME="cappucode.bin"
BR2_SKIBOOT_CUSTOM_VERSION=y
BR2_SKIBOOT_CUSTOM_VERSION_VALUE="3fd43cf66b7a799cd309833d51cd81117a66aaef"
BR2_SKIBOOT_CUSTOM_GIT=y
BR2_SKIBOOT_CUSTOM_REPO_URL="git@github.ibm.com:p10/skiboot.git"
BR2_PACKAGE_LOADKEYS=y
BR2_IMA_CATALOG_DTS="POWER9"
BR2_PACKAGE_OCMB_EXPLORER_FW=y
```
