## openpower/Config.in
```kconfig
menu "OpenPower"

source "$BR2_EXTERNAL_OP_BUILD_PATH/platform/Config.in"
source "$BR2_EXTERNAL_OP_BUILD_PATH/toolchain/Config.in"

menu "OpenPower Packages"
if BR2_OPENPOWER_PLATFORM
source "$BR2_EXTERNAL_OP_BUILD_PATH/package/Config.in"
endif
endmenu

menu "Custom Packages"
source "$BR2_EXTERNAL_OP_BUILD_PATH/custom/Config.in"
endmenu

endmenu
```

## openpower/configs/firestone_defconfig
```kconfig
BR2_powerpc64le=y
BR2_powerpc_power8=y
BR2_OPENPOWER_PLATFORM=y

BR2_BINUTILS_EXTRA_CONFIG_OPTIONS="--enable-targets=powerpc64-linux"
BR2_EXTRA_GCC_CONFIG_OPTIONS="--enable-targets=powerpc64-linux"
BR2_TOOLCHAIN_BUILDROOT_CXX=y
# BR2_TOOLCHAIN_BUILDROOT_LIBSTDCPP is not set

BR2_OPENPOWER_CONFIG_NAME="firestone"
BR2_OPENPOWER_XML_PACKAGE="firestone-xml"
BR2_HOSTBOOT_CONFIG_FILE="firestone.config"

BR2_HOSTBOOT_BINARY_SBE_FILENAME="venice_sbe.img.ecc"
BR2_HOSTBOOT_BINARY_SBEC_FILENAME="centaur_sbec_pad.img.ecc"
BR2_HOSTBOOT_BINARY_WINK_FILENAME="p8.ref_image.hdr.bin.ecc"

BR2_OCC_BIN_FILENAME="occ.bin"

BR2_FIRESTONE_SYSTEM_XML_FILENAME="FIRESTONE_hb.system.xml"
BR2_FIRESTONE_MRW_XML_FILENAME="FIRESTONE_hb.mrw.xml"
BR2_FIRESTONE_BIOS_XML_FILENAME="FIRESTONE_bios.xml"

BR2_OPENPOWER_TARGETING_BIN_FILENAME="FIRESTONE_HB.targeting.bin"
BR2_OPENPOWER_TARGETING_ECC_FILENAME="FIRESTONE_HB.targeting.bin.ecc"
BR2_CAPP_UCODE_BIN_FILENAME="cappucode.bin"

BR2_OPENPOWER_PNOR_XML_LAYOUT_FILENAME="defaultPnorLayoutWithGoldenSide.xml"
BR2_OPENPOWER_PNOR_FILENAME="firestone.pnor"
BR2_OPENPOWER_PNOR_UPDATE_FILENAME="firestone_update.pnor"

# skiboot requirements
BR2_TARGET_SKIBOOT=y
BR2_TARGET_SKIBOOT_EMBED_PAYLOAD=n

# petitboot requirements
BR2_ENABLE_LOCALE_PURGE=y
BR2_ENABLE_LOCALE_WHITELIST="C en_US"
BR2_GENERATE_LOCALE="en_US.UTF-8"
BR2_ROOTFS_DEVICE_CREATION_DYNAMIC_EUDEV=y
BR2_TARGET_GENERIC_GETTY_PORT="hvc0"
BR2_ROOTFS_OVERLAY="overlay"
BR2_LINUX_KERNEL=y
BR2_LINUX_KERNEL_CUSTOM_GIT=y
BR2_LINUX_KERNEL_CUSTOM_REPO_URL="git://github.com/open-power/linux.git"
BR2_LINUX_KERNEL_CUSTOM_REPO_VERSION="8adc30a30b88c793c2058e85426f4f94158797ad"
BR2_LINUX_KERNEL_USE_CUSTOM_CONFIG=y
BR2_LINUX_KERNEL_CUSTOM_CONFIG_FILE="$(BR2_EXTERNAL)/configs/linux/skiroot_defconfig"
BR2_LINUX_KERNEL_ZIMAGE_EPAPR=y
BR2_PACKAGE_BUSYBOX_SHOW_OTHERS=y
BR2_PACKAGE_LINUX_FIRMWARE=y
BR2_PACKAGE_LINUX_FIRMWARE_BNX2X=y
BR2_PACKAGE_LINUX_FIRMWARE_CXGB4=y
BR2_PACKAGE_I2C_TOOLS=y
BR2_PACKAGE_NCURSES_WCHAR=y
BR2_PACKAGE_DROPBEAR=y
# BR2_PACKAGE_DROPBEAR_SERVER is not set
BR2_PACKAGE_ETHTOOL=y
BR2_PACKAGE_NETCAT=y
BR2_PACKAGE_RSYNC=y
BR2_PACKAGE_PETITBOOT=y
BR2_PACKAGE_IPMITOOL=y
BR2_PACKAGE_POWERPC_UTILS=y
BR2_TARGET_ROOTFS_CPIO_XZ=y
BR2_TARGET_ROOTFS_INITRAMFS=y
```

## openpower/configs/habanero_defconfig
```kconfig
BR2_powerpc64le=y
BR2_powerpc_power8=y
BR2_GLIBC_VERSION_2_24=y
BR2_BINUTILS_VERSION_2_27_X=y
BR2_BINUTILS_EXTRA_CONFIG_OPTIONS="--enable-targets=powerpc64-linux"
BR2_GCC_VERSION_6_X=y
BR2_EXTRA_GCC_CONFIG_OPTIONS="--enable-targets=powerpc64-linux"
BR2_TOOLCHAIN_BUILDROOT_CXX=y
BR2_TARGET_GENERIC_HOSTNAME="skiroot"
BR2_ROOTFS_DEVICE_CREATION_DYNAMIC_EUDEV=y
BR2_ROOTFS_DEVICE_TABLE="../openpower/device_table.txt"
BR2_TARGET_GENERIC_GETTY_PORT="hvc0"
BR2_ENABLE_LOCALE_WHITELIST="C de en es fr it ja ko pt_BR ru zh_CN zh_TW"
BR2_GENERATE_LOCALE="en_US.UTF-8 de_DE.UTF-8 es_ES.UTF-8 fr_FR.UTF-8 it_IT.UTF-8 ja_JP.UTF-8 ko_KR.UTF-8 pt_BR.UTF-8 ru_RU.UTF-8 zh_CN.UTF-8 zh_TW.UTF-8"
BR2_ROOTFS_OVERLAY="../openpower/overlay"
BR2_ROOTFS_POST_BUILD_SCRIPT="../openpower/scripts/fixup-target-var ../openpower/scripts/firmware-whitelist"
BR2_LINUX_KERNEL=y
BR2_LINUX_KERNEL_CUSTOM_VERSION=y
BR2_LINUX_KERNEL_CUSTOM_VERSION_VALUE="4.10.6"
BR2_LINUX_KERNEL_PATCH="$(BR2_EXTERNAL_OP_BUILD_PATH)/linux"
BR2_LINUX_KERNEL_USE_CUSTOM_CONFIG=y
BR2_LINUX_KERNEL_CUSTOM_CONFIG_FILE="$(BR2_EXTERNAL_OP_BUILD_PATH)/configs/linux/skiroot_defconfig"
BR2_LINUX_KERNEL_ZIMAGE_EPAPR=y
BR2_PACKAGE_BUSYBOX_CONFIG_FRAGMENT_FILES="$(BR2_EXTERNAL_OP_BUILD_PATH)/configs/busybox.fragment"
BR2_PACKAGE_BUSYBOX_SHOW_OTHERS=y
BR2_PACKAGE_LINUX_FIRMWARE=y
BR2_PACKAGE_LINUX_FIRMWARE_BNX2X=y
BR2_PACKAGE_LINUX_FIRMWARE_CXGB4_T4=y
BR2_PACKAGE_I2C_TOOLS=y
BR2_PACKAGE_IPMITOOL=y
BR2_PACKAGE_MDADM=y
BR2_PACKAGE_NCURSES_WCHAR=y
BR2_PACKAGE_DROPBEAR=y
# BR2_PACKAGE_DROPBEAR_SERVER is not set
BR2_PACKAGE_ETHTOOL=y
BR2_PACKAGE_NETCAT=y
BR2_PACKAGE_RSYNC=y
BR2_TARGET_ROOTFS_CPIO_XZ=y
BR2_TARGET_ROOTFS_INITRAMFS=y
BR2_OPENPOWER_PLATFORM=y
BR2_OPENPOWER_POWER8=y
BR2_HOSTBOOT_CONFIG_FILE="habanero.config"
BR2_HABANERO_SYSTEM_XML_FILENAME="HABANERO_hb.system.xml"
BR2_HABANERO_MRW_XML_FILENAME="HABANERO_hb.mrw.xml"
BR2_HABANERO_BIOS_XML_FILENAME="HABANERO_bios.xml"
BR2_OPENPOWER_PNOR_XML_LAYOUT_FILENAME="defaultPnorLayoutWithGoldenSide.xml"
BR2_OPENPOWER_CONFIG_NAME="habanero"
BR2_OPENPOWER_XML_PACKAGE="habanero-xml"
BR2_OPENPOWER_PNOR_FILENAME="habanero.pnor"
BR2_OPENPOWER_PNOR_UPDATE_FILENAME="habanero_update.pnor"
BR2_HOSTBOOT_BINARY_SBE_FILENAME="venice_sbe.img.ecc"
BR2_HOSTBOOT_BINARY_SBEC_FILENAME="centaur_sbec_pad.img.ecc"
BR2_HOSTBOOT_BINARY_WINK_FILENAME="p8.ref_image.hdr.bin.ecc"
BR2_IMA_CATALOG_FILENAME="ima_catalog.bin"
BR2_OPENPOWER_TARGETING_BIN_FILENAME="HABANERO_HB.targeting.bin"
BR2_OPENPOWER_TARGETING_ECC_FILENAME="HABANERO_HB.targeting.bin.ecc"
BR2_PACKAGE_PETITBOOT=y
BR2_PACKAGE_PETITBOOT_MTD=y
BR2_OCC_BIN_FILENAME="occ.bin"
BR2_CAPP_UCODE_BIN_FILENAME="cappucode.bin"
BR2_PACKAGE_LOADKEYS=y
BR2_IMA_CATALOG_DTS="POWER8"
```

## openpower/configs/nicole_defconfig
```kconfig
BR2_powerpc64le=y
BR2_powerpc_power8=y
BR2_PACKAGE_HOST_LINUX_HEADERS_CUSTOM_5_4=y
BR2_BINUTILS_EXTRA_CONFIG_OPTIONS="--enable-targets=powerpc64-linux"
BR2_GCC_VERSION_6_X=y
BR2_EXTRA_GCC_CONFIG_OPTIONS="--enable-targets=powerpc64-linux --disable-libsanitizer"
BR2_TOOLCHAIN_BUILDROOT_CXX=y
BR2_TARGET_GENERIC_HOSTNAME="skiroot"
BR2_ROOTFS_DEVICE_CREATION_DYNAMIC_EUDEV=y
BR2_ROOTFS_DEVICE_TABLE="../openpower/device_table.txt"
BR2_TARGET_GENERIC_GETTY_PORT="hvc0"
BR2_GENERATE_LOCALE="en_US.UTF-8"
BR2_SYSTEM_ENABLE_NLS=y
BR2_ROOTFS_USERS_TABLES="$(BR2_EXTERNAL_OP_BUILD_PATH)/configs/users-table"
BR2_ROOTFS_OVERLAY="../openpower/overlay"
BR2_ROOTFS_POST_BUILD_SCRIPT="../openpower/scripts/fixup-target-var ../openpower/scripts/firmware-whitelist"
BR2_LINUX_KERNEL=y
BR2_LINUX_KERNEL_CUSTOM_VERSION=y
BR2_LINUX_KERNEL_CUSTOM_VERSION_VALUE="5.4.48"
BR2_LINUX_KERNEL_PATCH="$(BR2_EXTERNAL_OP_BUILD_PATH)/linux"
BR2_LINUX_KERNEL_USE_CUSTOM_CONFIG=y
BR2_LINUX_KERNEL_CUSTOM_CONFIG_FILE="$(BR2_EXTERNAL_OP_BUILD_PATH)/configs/linux/skiroot_defconfig"
BR2_LINUX_KERNEL_ZIMAGE_EPAPR=y
BR2_LINUX_KERNEL_XZ=y
BR2_LINUX_KERNEL_NEEDS_HOST_OPENSSL=y
BR2_PACKAGE_BUSYBOX_CONFIG_FRAGMENT_FILES="$(BR2_EXTERNAL_OP_BUILD_PATH)/configs/busybox.fragment"
BR2_PACKAGE_BUSYBOX_SHOW_OTHERS=y
BR2_PACKAGE_CRYPTSETUP=y
BR2_PACKAGE_IPMITOOL=y
BR2_PACKAGE_IPMITOOL_USB=y
BR2_PACKAGE_MDADM=y
BR2_PACKAGE_PCIUTILS=y
BR2_PACKAGE_NCURSES_WCHAR=y
BR2_PACKAGE_DROPBEAR=y
# BR2_PACKAGE_DROPBEAR_SERVER is not set
BR2_PACKAGE_ETHTOOL=y
BR2_PACKAGE_LRZSZ=y
BR2_PACKAGE_NETCAT=y
BR2_PACKAGE_RSYNC=y
BR2_PACKAGE_SUDO=y
BR2_PACKAGE_UTIL_LINUX_AGETTY=y
BR2_TARGET_ROOTFS_CPIO_XZ=y
BR2_TARGET_ROOTFS_INITRAMFS=y
BR2_OPENPOWER_PLATFORM=y
BR2_OPENPOWER_POWER9=y
BR2_HOSTBOOT_CONFIG_FILE="nicole.config"
BR2_OPENPOWER_MACHINE_XML_GITHUB_PROJECT_VALUE="nicole-xml"
BR2_OPENPOWER_MACHINE_XML_VERSION="ac025575c66dcf0bd1b62c397cdeb6b5f5499f38"
BR2_OPENPOWER_MACHINE_XML_FILENAME="nicole.xml"
BR2_OPENPOWER_SYSTEM_XML_FILENAME="NICOLE_hb.system.xml"
BR2_OPENPOWER_MRW_XML_FILENAME="NICOLE_hb.mrw.xml"
BR2_OPENPOWER_BIOS_XML_FILENAME="NICOLE_bios.xml"
BR2_OPENPOWER_PNOR_XML_LAYOUT_FILENAME="defaultPnorLayout_64.xml"
BR2_OPENPOWER_CONFIG_NAME="nicole"
BR2_OPENPOWER_PNOR_FILENAME="nicole.pnor"
BR2_HOSTBOOT_BINARY_SBE_FILENAME="nimbus_sbe.img.ecc"
BR2_HOSTBOOT_BINARY_SBEC_FILENAME="centaur_sbec_pad.img.ecc"
BR2_HOSTBOOT_BINARY_WINK_FILENAME="p9n.ref_image.hdr.bin.ecc"
BR2_IMA_CATALOG_FILENAME="ima_catalog.bin"
BR2_OPENPOWER_TARGETING_BIN_FILENAME="NICOLE_HB.targeting.bin"
BR2_OPENPOWER_TARGETING_ECC_FILENAME="NICOLE_HB.targeting.bin.ecc"
BR2_PACKAGE_PETITBOOT=y
BR2_PACKAGE_PETITBOOT_MTD=y
# BR2_HCODE_INCLUDE_IONV is not set
BR2_CAPP_UCODE_BIN_FILENAME="cappucode.bin"
BR2_PACKAGE_LOADKEYS=y
BR2_IMA_CATALOG_DTS="POWER9"
```

## openpower/configs/opal_defconfig
```kconfig
BR2_powerpc64le=y
BR2_powerpc_power8=y
BR2_PACKAGE_HOST_LINUX_HEADERS_CUSTOM_5_4=y
BR2_BINUTILS_EXTRA_CONFIG_OPTIONS="--enable-targets=powerpc64-linux"
BR2_EXTRA_GCC_CONFIG_OPTIONS="--enable-targets=powerpc64-linux --disable-libsanitizer"
BR2_TARGET_GENERIC_HOSTNAME="skiroot"
BR2_ROOTFS_DEVICE_CREATION_DYNAMIC_EUDEV=y
BR2_ROOTFS_DEVICE_TABLE="../openpower/device_table.txt"
BR2_TARGET_GENERIC_GETTY_PORT="hvc0"
BR2_GENERATE_LOCALE="en_US.UTF-8"
BR2_ROOTFS_USERS_TABLES="$(BR2_EXTERNAL_OP_BUILD_PATH)/configs/users-table"
BR2_ROOTFS_OVERLAY="../openpower/overlay"
BR2_ROOTFS_POST_BUILD_SCRIPT="../openpower/scripts/fixup-target-var ../openpower/scripts/firmware-whitelist"
BR2_LINUX_KERNEL=y
BR2_LINUX_KERNEL_CUSTOM_VERSION=y
BR2_LINUX_KERNEL_CUSTOM_VERSION_VALUE="5.4.48"
BR2_LINUX_KERNEL_PATCH="$(BR2_EXTERNAL_OP_BUILD_PATH)/linux"
BR2_LINUX_KERNEL_USE_CUSTOM_CONFIG=y
BR2_LINUX_KERNEL_CUSTOM_CONFIG_FILE="$(BR2_EXTERNAL_OP_BUILD_PATH)/configs/linux/skiroot_defconfig"
BR2_LINUX_KERNEL_ZIMAGE_EPAPR=y
BR2_LINUX_KERNEL_XZ=y
BR2_LINUX_KERNEL_NEEDS_HOST_OPENSSL=y
BR2_PACKAGE_BUSYBOX_CONFIG_FRAGMENT_FILES="$(BR2_EXTERNAL_OP_BUILD_PATH)/configs/busybox.fragment"
BR2_PACKAGE_BUSYBOX_SHOW_OTHERS=y
BR2_PACKAGE_LINUX_FIRMWARE=y
BR2_PACKAGE_LINUX_FIRMWARE_BNX2X=y
BR2_PACKAGE_LINUX_FIRMWARE_CXGB4_T4=y
BR2_PACKAGE_CRYPTSETUP=y
BR2_PACKAGE_IPMITOOL=y
BR2_PACKAGE_IPMITOOL_USB=y
BR2_PACKAGE_MDADM=y
BR2_PACKAGE_PCIUTILS=y
BR2_PACKAGE_NCURSES_WCHAR=y
BR2_PACKAGE_DROPBEAR=y
# BR2_PACKAGE_DROPBEAR_SERVER is not set
BR2_PACKAGE_ETHTOOL=y
BR2_PACKAGE_LRZSZ=y
BR2_PACKAGE_NETCAT=y
BR2_PACKAGE_RSYNC=y
BR2_PACKAGE_SUDO=y
BR2_PACKAGE_UTIL_LINUX_AGETTY=y
BR2_TARGET_ROOTFS_CPIO_XZ=y
BR2_TARGET_ROOTFS_INITRAMFS=y
BR2_OPENPOWER_PLATFORM=y
BR2_OPENPOWER_POWER9=y
# BR2_PACKAGE_PPE42_TOOLCHAIN is not set
# BR2_PACKAGE_HOST_OPENPOWER_FFS is not set
# BR2_PACKAGE_HOSTBOOT is not set
# BR2_PACKAGE_HOSTBOOT_BINARIES is not set
# BR2_PACKAGE_MACHINE_XML is not set
# BR2_PACKAGE_OPENPOWER_PNOR is not set
BR2_OPENPOWER_CONFIG_NAME="opal"
BR2_PACKAGE_PETITBOOT=y
BR2_PACKAGE_PETITBOOT_MTD=y
# BR2_PACKAGE_CAPP_UCODE is not set
BR2_SKIBOOT_DEVICETREE=y
# BR2_PACKAGE_IMA_CATALOG is not set
# BR2_PACKAGE_HOST_SB_SIGNING_UTILS is not set
```

## openpower/configs/openpower_mambo_defconfig
```kconfig
BR2_powerpc64le=y
BR2_powerpc_power8=y
BR2_OPENPOWER_PLATFORM=y

BR2_BINUTILS_EXTRA_CONFIG_OPTIONS="--enable-targets=powerpc64-linux"
BR2_EXTRA_GCC_CONFIG_OPTIONS="--enable-targets=powerpc64-linux"
BR2_GLIBC_VERSION_2_23=y

# No HostBoot for Mambo
BR2_PACKAGE_HOSTBOOT=n
BR2_PACKAGE_HOSTBOOT_BINARIES=n

BR2_OPENPOWER_CONFIG_NAME="openpower-mambo"

# no OCC for Mambo either
BR2_PACKAGE_OCC=n

# we don't need a PNOR layout for Mambo
BR2_PACKAGE_OPENPOWER_PNOR=n

BR2_TARGET_GENERIC_HOSTNAME="skiroot"

# petitboot requirements
BR2_ENABLE_LOCALE_PURGE=y
BR2_ENABLE_LOCALE_WHITELIST="C en_US"
BR2_GENERATE_LOCALE="en_US.UTF-8"
BR2_ROOTFS_DEVICE_CREATION_DYNAMIC_EUDEV=y
BR2_TARGET_GENERIC_GETTY_PORT="hvc0"
BR2_ROOTFS_OVERLAY="../openpower/overlay"
BR2_ROOTFS_DEVICE_TABLE="../openpower/device_table.txt"
BR2_ROOTFS_POST_BUILD_SCRIPT="../openpower/scripts/fixup-target-var"
BR2_LINUX_KERNEL=y
BR2_LINUX_KERNEL_CUSTOM_VERSION=y
BR2_LINUX_KERNEL_CUSTOM_VERSION_VALUE="4.4.227"
BR2_KERNEL_HEADERS_4_4=y
BR2_BINUTILS_VERSION_2_26_X=y
BR2_LINUX_KERNEL_PATCH="$(BR2_EXTERNAL)/linux"
BR2_LINUX_KERNEL_USE_CUSTOM_CONFIG=y
BR2_LINUX_KERNEL_CUSTOM_CONFIG_FILE="$(BR2_EXTERNAL)/configs/linux/skiroot_defconfig"
BR2_LINUX_KERNEL_ZIMAGE_EPAPR=y
BR2_PACKAGE_BUSYBOX_SHOW_OTHERS=y
BR2_PACKAGE_LINUX_FIRMWARE=y
BR2_PACKAGE_LINUX_FIRMWARE_BNX2X=y
BR2_PACKAGE_LINUX_FIRMWARE_CXGB4_T4=y
BR2_PACKAGE_I2C_TOOLS=y
BR2_PACKAGE_NCURSES_WCHAR=y
BR2_PACKAGE_DROPBEAR=y
# BR2_PACKAGE_DROPBEAR_SERVER is not set
BR2_PACKAGE_ETHTOOL=y
BR2_PACKAGE_NETCAT=y
BR2_PACKAGE_RSYNC=y
BR2_PACKAGE_PETITBOOT=y
BR2_PACKAGE_IPMITOOL=y
BR2_PACKAGE_MDADM=y
BR2_TARGET_ROOTFS_CPIO_XZ=y
BR2_TARGET_ROOTFS_INITRAMFS=y
```

## openpower/configs/openpower_p9_mambo_defconfig
```kconfig
BR2_powerpc64le=y
BR2_powerpc_power8=y
BR2_KERNEL_HEADERS_4_4=y
BR2_GCC_VERSION_6_X=y
BR2_BINUTILS_VERSION_2_26_X=y
BR2_BINUTILS_EXTRA_CONFIG_OPTIONS="--enable-targets=powerpc64-linux"
BR2_EXTRA_GCC_CONFIG_OPTIONS="--enable-targets=powerpc64-linux"
BR2_TARGET_GENERIC_HOSTNAME="skiroot-p9"
BR2_ROOTFS_DEVICE_CREATION_DYNAMIC_EUDEV=y
BR2_ROOTFS_DEVICE_TABLE="../openpower/device_table.txt"
BR2_TARGET_GENERIC_GETTY_PORT="hvc0"
BR2_GENERATE_LOCALE="en_US.UTF-8"
BR2_ROOTFS_OVERLAY="../openpower/overlay"
BR2_ROOTFS_POST_BUILD_SCRIPT="../openpower/scripts/fixup-target-var"
BR2_LINUX_KERNEL=y
BR2_LINUX_KERNEL_CUSTOM_TARBALL=y
BR2_LINUX_KERNEL_CUSTOM_TARBALL_LOCATION="https://cdn.kernel.org/pub/linux/kernel/v4.x/testing/linux-4.8-rc5.tar.xz"
BR2_LINUX_KERNEL_USE_CUSTOM_CONFIG=y
BR2_LINUX_KERNEL_CUSTOM_CONFIG_FILE="$(BR2_EXTERNAL)/configs/linux/skiroot_defconfig"
BR2_LINUX_KERNEL_ZIMAGE_EPAPR=y
BR2_PACKAGE_BUSYBOX_SHOW_OTHERS=y
BR2_PACKAGE_LINUX_FIRMWARE=y
BR2_PACKAGE_LINUX_FIRMWARE_BNX2X=y
BR2_PACKAGE_LINUX_FIRMWARE_CXGB4_T4=y
BR2_PACKAGE_I2C_TOOLS=y
BR2_PACKAGE_IPMITOOL=y
BR2_PACKAGE_MDADM=y
BR2_PACKAGE_NCURSES_WCHAR=y
BR2_PACKAGE_DROPBEAR=y
# BR2_PACKAGE_DROPBEAR_SERVER is not set
BR2_PACKAGE_ETHTOOL=y
BR2_PACKAGE_NETCAT=y
BR2_PACKAGE_RSYNC=y
BR2_TARGET_ROOTFS_CPIO_XZ=y
BR2_TARGET_ROOTFS_INITRAMFS=y
BR2_OPENPOWER_POWER9=y
BR2_OPENPOWER_PLATFORM=y
# BR2_PACKAGE_HOSTBOOT is not set
# BR2_PACKAGE_HOSTBOOT_BINARIES is not set
# BR2_PACKAGE_OPENPOWER_PNOR is not set
BR2_OPENPOWER_CONFIG_NAME="openpower-mambo-p9"
BR2_PACKAGE_PETITBOOT=y
# BR2_PACKAGE_OCC is not set
```
