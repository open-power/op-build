## openpower/package/blueridge-4u-xml/Config.in
```kconfig
menu "Blueridge 4U XML (MRW)"

config BR2_PACKAGE_BLUERIDGE_4U_XML
        bool "blueridge_4u_xml"

if BR2_PACKAGE_BLUERIDGE_4U_XML

choice
	prompt "Blueridge 4U XML location"

config BR2_BLUERIDGE_4U_XML_GITHUB_PROJECT
       bool "OpenPOWER Github project name"

config BR2_BLUERIDGE_4U_XML_CUSTOM_GIT
       bool "Custom URL of Blueridge 4U xml repository"

endchoice

config BR2_BLUERIDGE_4U_XML_FILTER_UNWANTED_ATTRIBUTES
       bool "Filter Unwanted Attributes"
       default y

config BR2_BLUERIDGE_4U_XML_OPPOWERVM_ATTRIBUTES
       bool "OPPOWERVM Attributes/Target"
       default y

config BR2_BLUERIDGE_4U_XML_TARGET_TYPES_OPENPOWER_XML
       bool "Include target_types_openpower.xml"
       default y

config BR2_BLUERIDGE_4U_XML_CUSTOM_GIT_VALUE
	string "URL of Blueridge 4U xml repository"
	depends on BR2_BLUERIDGE_4U_XML_CUSTOM_GIT

config BR2_BLUERIDGE_4U_XML_GITHUB_PROJECT_VALUE
       string "The Github project name (e.g. blueridge-4u-xml)"
       default "blueridge-4u-xml"
       depends on BR2_BLUERIDGE_4U_XML_GITHUB_PROJECT

config BR2_BLUERIDGE_4U_XML_VERSION
       string "Version of Blueridge 4U XML"

config BR2_BLUERIDGE_4U_XML_FILENAME
       string "Blueridge 4U XML filename (e.g. Blueridge-4U-MRW.xml)"
       default "Blueridge-4U-MRW.xml"
       help
           The name of the MRW XML file. Note that this file MUST
           come with the '.xml' prefix (all lowercase)

config BR2_BLUERIDGE_4U_XML_SYSTEM_FILENAME
        string "Targeting Blueridge 4U system xml filename"
        default ""
        help
            Defines the name of the system XML filename
            to be used when creating targeting binary image

config BR2_BLUERIDGE_4U_XML_TARGETING_FILENAME
        string "Targeting Blueridge 4U mrw xml filename"
        default ""
        help
            Defines the name of the mrw XML filename
            to be used when creating targeting binary image

config BR2_BLUERIDGE_4U_XML_TARGETING_BIN_FILENAME
        string "Name of the openpower binary targeting file"
        default "Blueridge-4U-MRW.targeting.bin"
        help
            String used to define name of openpower targeting binary file

config BR2_BLUERIDGE_4U_XML_TARGETING_ECC_FILENAME
        string "Name of the openpower binary targeting ecc file"
        default "Blueridge-4U-MRW.targeting.bin.ecc"
        help
            String used to define name of openpower
            targeting binary file, ecc protected

endif

endmenu
```
