## openpower/configs/vesnin_defconfig
```kconfig
BR2_powerpc64le=y
BR2_powerpc_power8=y
BR2_GLOBAL_PATCH_DIR="$(BR2_EXTERNAL_OP_BUILD_PATH)/patches/vesnin-patches"
BR2_BINUTILS_EXTRA_CONFIG_OPTIONS="--enable-targets=powerpc64-linux"
BR2_GCC_VERSION_6_X=y
BR2_EXTRA_GCC_CONFIG_OPTIONS="--enable-targets=powerpc64-linux --disable-libsanitizer"
BR2_TOOLCHAIN_BUILDROOT_CXX=y
BR2_TARGET_GENERIC_HOSTNAME="skiroot"
BR2_ROOTFS_DEVICE_CREATION_DYNAMIC_EUDEV=y
BR2_ROOTFS_DEVICE_TABLE="../openpower/device_table.txt"
BR2_TARGET_GENERIC_GETTY_PORT="hvc0"
BR2_GENERATE_LOCALE="en_US.UTF-8"
BR2_ROOTFS_USERS_TABLES="$(BR2_EXTERNAL_OP_BUILD_PATH)/configs/users-table"
BR2_ROOTFS_OVERLAY="../openpower/overlay"
BR2_ROOTFS_POST_BUILD_SCRIPT="../openpower/scripts/fixup-target-var ../openpower/scripts/firmware-whitelist"
BR2_LINUX_KERNEL=y
BR2_LINUX_KERNEL_CUSTOM_VERSION=y
BR2_LINUX_KERNEL_CUSTOM_VERSION_VALUE="5.2.1"
BR2_LINUX_KERNEL_PATCH="$(BR2_EXTERNAL_OP_BUILD_PATH)/linux"
BR2_LINUX_KERNEL_USE_CUSTOM_CONFIG=y
BR2_LINUX_KERNEL_CUSTOM_CONFIG_FILE="$(BR2_EXTERNAL_OP_BUILD_PATH)/configs/linux/skiroot_defconfig"
BR2_LINUX_KERNEL_ZIMAGE_EPAPR=y
BR2_LINUX_KERNEL_XZ=y
BR2_LINUX_KERNEL_NEEDS_HOST_OPENSSL=y
BR2_PACKAGE_BUSYBOX_CONFIG_FRAGMENT_FILES="$(BR2_EXTERNAL_OP_BUILD_PATH)/configs/busybox.fragment"
BR2_PACKAGE_BUSYBOX_SHOW_OTHERS=y
BR2_PACKAGE_LINUX_FIRMWARE=y
BR2_PACKAGE_LINUX_FIRMWARE_BNX2X=y
BR2_PACKAGE_LINUX_FIRMWARE_QLOGIC_4X=y
BR2_PACKAGE_CRYPTSETUP=y
BR2_PACKAGE_I2C_TOOLS=y
BR2_PACKAGE_IPMITOOL=y
BR2_PACKAGE_MDADM=y
BR2_PACKAGE_NCURSES_WCHAR=y
BR2_PACKAGE_DROPBEAR=y
# BR2_PACKAGE_DROPBEAR_SERVER is not set
BR2_PACKAGE_ETHTOOL=y
BR2_PACKAGE_NETCAT=y
BR2_PACKAGE_RSYNC=y
BR2_PACKAGE_SUDO=y
BR2_PACKAGE_UTIL_LINUX_AGETTY=y
BR2_TARGET_ROOTFS_CPIO_XZ=y
BR2_TARGET_ROOTFS_INITRAMFS=y
BR2_OPENPOWER_PLATFORM=y
BR2_OPENPOWER_POWER8=y
BR2_HOSTBOOT_P8_CONFIG_FILE="vesnin.config"
BR2_OPENPOWER_MACHINE_XML_GITHUB_PROJECT_VALUE="vesnin-xml"
BR2_OPENPOWER_MACHINE_XML_VERSION="deed9ba0bc6d1d68b416ed3e14853b86838897d7"
BR2_OPENPOWER_MACHINE_XML_FILENAME="vesnin.xml"
BR2_OPENPOWER_SYSTEM_XML_FILENAME="VESNIN_hb.system.xml"
BR2_OPENPOWER_MRW_XML_FILENAME="VESNIN_hb.mrw.xml"
BR2_OPENPOWER_BIOS_XML_FILENAME="VESNIN_bios.xml"
BR2_OPENPOWER_PNOR_XML_LAYOUT_FILENAME="defaultPnorLayoutWithGoldenSide.xml"
BR2_OPENPOWER_CONFIG_NAME="vesnin"
BR2_OPENPOWER_PNOR_FILENAME="vesnin.pnor"
BR2_OPENPOWER_PNOR_UPDATE_FILENAME="vesnin_update.pnor"
BR2_HOSTBOOT_BINARY_SBE_FILENAME="venice_sbe.img.ecc"
BR2_HOSTBOOT_BINARY_SBEC_FILENAME="centaur_sbec_pad.img.ecc"
BR2_HOSTBOOT_BINARY_WINK_FILENAME="p8.ref_image.hdr.bin.ecc"
BR2_IMA_CATALOG_FILENAME="ima_catalog.bin"
BR2_OPENPOWER_TARGETING_BIN_FILENAME="VESNIN_HB.targeting.bin"
BR2_OPENPOWER_TARGETING_ECC_FILENAME="VESNIN_HB.targeting.bin.ecc"
BR2_PACKAGE_PETITBOOT=y
BR2_PACKAGE_PETITBOOT_MTD=y
BR2_CAPP_UCODE_BIN_FILENAME="cappucode.bin"
BR2_PACKAGE_LOADKEYS=y
BR2_IMA_CATALOG_DTS="POWER8"
```

## openpower/configs/zaius_defconfig
```kconfig
BR2_powerpc64le=y
BR2_powerpc_power8=y
BR2_GLIBC_VERSION_2_24=y
BR2_BINUTILS_VERSION_2_27_X=y
BR2_BINUTILS_EXTRA_CONFIG_OPTIONS="--enable-targets=powerpc64-linux"
BR2_GCC_VERSION_4_9_X=y
BR2_EXTRA_GCC_CONFIG_OPTIONS="--enable-targets=powerpc64-linux"
BR2_TOOLCHAIN_BUILDROOT_CXX=y
BR2_TARGET_GENERIC_HOSTNAME="skiroot"
BR2_ROOTFS_DEVICE_CREATION_DYNAMIC_EUDEV=y
BR2_ROOTFS_DEVICE_TABLE="../openpower/device_table.txt"
BR2_TARGET_GENERIC_GETTY_PORT="hvc0"
BR2_ENABLE_LOCALE_WHITELIST="C de en es fr it ja ko pt_BR ru zh_CN zh_TW"
BR2_GENERATE_LOCALE="en_US.UTF-8 de_DE.UTF-8 es_ES.UTF-8 fr_FR.UTF-8 it_IT.UTF-8 ja_JP.UTF-8 ko_KR.UTF-8 pt_BR.UTF-8 ru_RU.UTF-8 zh_CN.UTF-8 zh_TW.UTF-8"
BR2_ROOTFS_OVERLAY="../openpower/overlay"
BR2_ROOTFS_POST_BUILD_SCRIPT="../openpower/scripts/fixup-target-var ../openpower/scripts/firmware-whitelist"
BR2_LINUX_KERNEL=y
BR2_LINUX_KERNEL_CUSTOM_VERSION=y
BR2_LINUX_KERNEL_CUSTOM_VERSION_VALUE="4.10.7"
BR2_LINUX_KERNEL_PATCH="$(BR2_EXTERNAL_OP_BUILD_PATH)/linux"
BR2_LINUX_KERNEL_USE_CUSTOM_CONFIG=y
BR2_LINUX_KERNEL_CUSTOM_CONFIG_FILE="$(BR2_EXTERNAL_OP_BUILD_PATH)/configs/linux/skiroot_p9_defconfig"
BR2_LINUX_KERNEL_ZIMAGE_EPAPR=y
BR2_LINUX_KERNEL_XZ=y
BR2_PACKAGE_BUSYBOX_CONFIG_FRAGMENT_FILES="$(BR2_EXTERNAL)/configs/busybox.fragment"
BR2_PACKAGE_BUSYBOX_SHOW_OTHERS=y
BR2_PACKAGE_LINUX_FIRMWARE=y
BR2_PACKAGE_LINUX_FIRMWARE_BNX2X=y
BR2_PACKAGE_LINUX_FIRMWARE_CXGB4_T4=y
BR2_PACKAGE_I2C_TOOLS=y
BR2_PACKAGE_IPMITOOL=y
BR2_PACKAGE_MDADM=y
BR2_PACKAGE_NCURSES_WCHAR=y
BR2_PACKAGE_DROPBEAR=y
# BR2_PACKAGE_DROPBEAR_SERVER is not set
BR2_PACKAGE_ETHTOOL=y
BR2_PACKAGE_NETCAT=y
BR2_PACKAGE_RSYNC=y
BR2_TARGET_ROOTFS_CPIO_XZ=y
BR2_TARGET_ROOTFS_INITRAMFS=y
BR2_OPENPOWER_PLATFORM=y
BR2_OPENPOWER_POWER9=y
BR2_HOSTBOOT_CONFIG_FILE="zaius.config"
BR2_OPENPOWER_PNOR_XML_LAYOUT_FILENAME="defaultPnorLayout_64.xml"
BR2_OPENPOWER_CONFIG_NAME="zaius"
BR2_OPENPOWER_XML_PACKAGE="zaius-xml"
BR2_OPENPOWER_PNOR_FILENAME="zaius.pnor"
BR2_HOSTBOOT_BINARY_SBE_FILENAME="nimbus_sbe.img.ecc"
BR2_HOSTBOOT_BINARY_SBEC_FILENAME="centaur_sbec_pad.img.ecc"
BR2_HOSTBOOT_BINARY_WINK_FILENAME="p9n.ref_image.hdr.bin.ecc"
BR2_IMA_CATALOG_FILENAME="ima_catalog.bin"
BR2_OPENPOWER_TARGETING_BIN_FILENAME="ZAIUS_HB.targeting.bin"
BR2_OPENPOWER_TARGETING_ECC_FILENAME="ZAIUS_HB.targeting.bin.ecc"
BR2_PACKAGE_PETITBOOT=y
BR2_PACKAGE_PETITBOOT_MTD=y
BR2_OCC_BIN_FILENAME="occ.bin"
BR2_CAPP_UCODE_BIN_FILENAME="cappucode.bin"
BR2_SKIBOOT_CUSTOM_VERSION=y
BR2_SKIBOOT_CUSTOM_VERSION_VALUE="f0ebbc8318e64870a68d337e77b0257678c2b055"
BR2_PACKAGE_LOADKEYS=y
BR2_ZAIUS_SYSTEM_XML_FILENAME="ZAIUS_hb.system.xml"
BR2_ZAIUS_MRW_XML_FILENAME="ZAIUS_hb.mrw.xml"
BR2_ZAIUS_BIOS_XML_FILENAME="ZAIUS_bios.xml"
BR2_IMA_CATALOG_DTS="POWER9"
```

## openpower/custom/package/wqy-zenhei/Config.in
```kconfig
config BR2_PACKAGE_WQY_ZENHEI
	bool "wqy-zenhei (Free Chinese-capable fonts)"
	help
	  Chinese-capable fonts for Framebuffer of X usage
```

## openpower/package/Config.in
```kconfig
source "$BR2_EXTERNAL_OP_BUILD_PATH/package/alternate-binutils/Config.in"
source "$BR2_EXTERNAL_OP_BUILD_PATH/package/alternate-gcc/Config.in"
source "$BR2_EXTERNAL_OP_BUILD_PATH/package/openpower-ffs/Config.in"
source "$BR2_EXTERNAL_OP_BUILD_PATH/package/ibm-fw-proprietary-p10/Config.in"
source "$BR2_EXTERNAL_OP_BUILD_PATH/package/hostboot/Config.in"
source "$BR2_EXTERNAL_OP_BUILD_PATH/package/hostboot-p10/Config.in"
source "$BR2_EXTERNAL_OP_BUILD_PATH/package/hostboot-binaries/Config.in"
source "$BR2_EXTERNAL_OP_BUILD_PATH/package/machine-xml/Config.in"
source "$BR2_EXTERNAL_OP_BUILD_PATH/package/rainier-2u-xml/Config.in"
source "$BR2_EXTERNAL_OP_BUILD_PATH/package/rainier-4u-xml/Config.in"
source "$BR2_EXTERNAL_OP_BUILD_PATH/package/everest-xml/Config.in"
source "$BR2_EXTERNAL_OP_BUILD_PATH/package/openpower-pnor/Config.in"
source "$BR2_EXTERNAL_OP_BUILD_PATH/package/openpower-pnor-p10/Config.in"
source "$BR2_EXTERNAL_OP_BUILD_PATH/package/petitboot/Config.in"
source "$BR2_EXTERNAL_OP_BUILD_PATH/package/hcode/Config.in"
source "$BR2_EXTERNAL_OP_BUILD_PATH/package/hcode-p10/Config.in"
source "$BR2_EXTERNAL_OP_BUILD_PATH/package/occ/Config.in"
source "$BR2_EXTERNAL_OP_BUILD_PATH/package/occ-p10/Config.in"
source "$BR2_EXTERNAL_OP_BUILD_PATH/package/capp-ucode/Config.in"
source "$BR2_EXTERNAL_OP_BUILD_PATH/package/skiboot/Config.in"
source "$BR2_EXTERNAL_OP_BUILD_PATH/package/libflash/Config.in"
source "$BR2_EXTERNAL_OP_BUILD_PATH/package/loadkeys/Config.in"
source "$BR2_EXTERNAL_OP_BUILD_PATH/package/ima-catalog/Config.in"
source "$BR2_EXTERNAL_OP_BUILD_PATH/package/sbe/Config.in"
source "$BR2_EXTERNAL_OP_BUILD_PATH/package/sbe-p10/Config.in"
source "$BR2_EXTERNAL_OP_BUILD_PATH/package/sb-signing-utils/Config.in"
source "$BR2_EXTERNAL_OP_BUILD_PATH/package/sb-signing-framework/Config.in"
source "$BR2_EXTERNAL_OP_BUILD_PATH/package/ocmb-explorer-fw/Config.in"
source "$BR2_EXTERNAL_OP_BUILD_PATH/package/fsp-trace/Config.in"
source "$BR2_EXTERNAL_OP_BUILD_PATH/package/ekb/Config.in"
source "$BR2_EXTERNAL_OP_BUILD_PATH/package/pdata/Config.in"
```

## openpower/package/alternate-binutils/Config.in
```kconfig
config BR2_PACKAGE_ALTERNATE_BINUTILS
		bool "alternate-binutils"
		select BR2_CPP
		help
		  Build Binutils for an Alternate Toolchain, for use in
		  certain packages

if BR2_PACKAGE_ALTERNATE_BINUTILS

config BR2_ALTERNATE_BINUTILS_VERSION
		string "Alternate Toolchain Binutils Version"
		default "2.31.1"

config BR2_ALTERNATE_BINUTILS_EXTRA_CONFIG_OPTIONS
		string "Extra configure options for Alternate Toolchain binutils"
		default BR2_BINUTILS_EXTRA_CONFIG_OPTIONS
		help
		  Any extra options to the Alternate Toolchain's binutils
		  configure script. The default is taken from
		  BINUTILS_EXTRA_CONFIG_OPTIONS

endif
```

## openpower/package/alternate-gcc/Config.in
```kconfig
config BR2_PACKAGE_ALTERNATE_GCC
		bool "alternate-gcc"
		select BR2_PACKAGE_ALTERNATE_BINUTILS
		help
		  Build gcc for an Alternate Toolchain, for use in
		  certain packages.


if BR2_PACKAGE_ALTERNATE_GCC

config BR2_ALTERNATE_GCC_VERSION
		string "Alternate gcc version"
		default "8.4.0"

config BR2_ALTERNATE_GCC_EXTRA_CONFIG_OPTIONS
		string "Extra configure options for Alternate Toolchain GCC"
		default BR2_EXTRA_GCC_CONFIG_OPTIONS
		help
		  Any extra options to the Alternate Toolchain's gcc configure script
		  The default is taken from EXTRA_GCC_CONFIG_OPTIONS

endif
```

## openpower/package/balcones-xml/Config.in
```kconfig
menu "Balcones XML (MRW)"

config BR2_PACKAGE_BALCONES_XML
        bool "balcones_xml"

if BR2_PACKAGE_BALCONES_XML

choice
	prompt "Balcones XML location"

config BR2_BALCONES_XML_GITHUB_PROJECT
       bool "OpenPOWER Github project name"

config BR2_BALCONES_XML_CUSTOM_GIT
       bool "Custom URL of Balcones xml repository"

endchoice

config BR2_BALCONES_XML_FILTER_UNWANTED_ATTRIBUTES
       bool "Filter Unwanted Attributes"
       default y

config BR2_BALCONES_XML_OPPOWERVM_ATTRIBUTES
       bool "OPPOWERVM Attributes/Target"
       default y

config BR2_BALCONES_XML_TARGET_TYPES_OPENPOWER_XML
       bool "Include target_types_openpower.xml"
       default y

config BR2_BALCONES_XML_CUSTOM_GIT_VALUE
	string "URL of Balcones xml repository"
	depends on BR2_BALCONES_XML_CUSTOM_GIT

config BR2_BALCONES_XML_GITHUB_PROJECT_VALUE
       string "The Github project name (e.g. balcones-xml)"
       default "balcones-xml"
       depends on BR2_BALCONES_XML_GITHUB_PROJECT

config BR2_BALCONES_XML_VERSION
       string "Version of Balcones XML"

config BR2_BALCONES_XML_FILENAME
       string "Balcones XML filename (e.g. balcones-mrw.xml)"
       default "balcones-mrw.xml"
       help
           The name of the MRW XML file. Note that this file MUST
           come with the '.xml' prefix (all lowercase)

config BR2_BALCONES_XML_SYSTEM_FILENAME
       string "Targeting Balcones system xml filename"
       default ""
       help
           Defines the name of the system XML filename
           to be used when creating targeting binary image

config BR2_BALCONES_XML_TARGETING_FILENAME
       string "Targeting Balcones mrw xml filename"
       default ""
       help
           Defines the name of the mrw XML filename
           to be used when creating targeting binary image

config BR2_BALCONES_XML_BIOS_FILENAME
       string "BIOS Balcones metadata XML filename"
       default "Balcones-MRW_bios.xml"
       help
           Defines the name of the BIOS XML filename
           to parse when generating BIOS metadata

config BR2_BALCONES_XML_TARGETING_BIN_FILENAME
       string "Name of the openpower binary targeting file"
       default "Balcones-MRW.targeting.bin"
       help
           String used to define name of openpower targeting binary file

config BR2_BALCONES_XML_TARGETING_ECC_FILENAME
       string "Name of the openpower binary targeting ecc file"
       default "Balcones-MRW.targeting.bin.ecc"
       help
           String used to define name of openpower
           targeting binary file, ecc protected

endif

endmenu
```

## openpower/package/barreleye-xml/Config.in
```kconfig
config BR2_PACKAGE_BARRELEYE_XML
        bool "barreleye_xml"
        default y if (BR2_OPENPOWER_CONFIG_NAME = "barreleye")
        help
            Utilites for building xml and the targeting binary image

config BR2_BARRELEYE_SYSTEM_XML_FILENAME
        string "Barreleye targeting system xml filename"
        default ""
        help
            Defines the name of the system XML filename to be used when creating targeting binary image

config BR2_BARRELEYE_MRW_XML_FILENAME
        string "Barreleye targeting mrw xml filename"
        default ""
        help
            Defines the name of the mrw XML filename to be used when creating targeting binary image

config BR2_BARRELEYE_BIOS_XML_FILENAME
        string "Barreleye BIOS metadata XML filename"
        default ""
        help
            Defines the name of the BIOS XML filename to parse when generating BIOS metadata
```

## openpower/package/blueridge-2u-xml/Config.in
```kconfig
menu "Blueridge 2U XML (MRW)"

config BR2_PACKAGE_BLUERIDGE_2U_XML
        bool "blueridge_2u_xml"

if BR2_PACKAGE_BLUERIDGE_2U_XML

choice
	prompt "Blueridge 2U XML location"

config BR2_BLUERIDGE_2U_XML_GITHUB_PROJECT
       bool "OpenPOWER Github project name"

config BR2_BLUERIDGE_2U_XML_CUSTOM_GIT
       bool "Custom URL of Blueridge 2U xml repository"

endchoice

config BR2_BLUERIDGE_2U_XML_FILTER_UNWANTED_ATTRIBUTES
       bool "Filter Unwanted Attributes"
       default y

config BR2_BLUERIDGE_2U_XML_OPPOWERVM_ATTRIBUTES
       bool "OPPOWERVM Attributes/Target"
       default y

config BR2_BLUERIDGE_2U_XML_TARGET_TYPES_OPENPOWER_XML
       bool "Include target_types_openpower.xml"
       default y

config BR2_BLUERIDGE_2U_XML_CUSTOM_GIT_VALUE
	string "URL of Blueridge 2U xml repository"
	depends on BR2_BLUERIDGE_2U_XML_CUSTOM_GIT

config BR2_BLUERIDGE_2U_XML_GITHUB_PROJECT_VALUE
       string "The Github project name (e.g. blueridge-2u-xml)"
       default "blueridge-2u-xml"
       depends on BR2_BLUERIDGE_2U_XML_GITHUB_PROJECT

config BR2_BLUERIDGE_2U_XML_VERSION
       string "Version of Blueridge 2U XML"

config BR2_BLUERIDGE_2U_XML_FILENAME
       string "Blueridge 2U XML filename (e.g. Blueridge-2U-MRW.xml)"
       default "Blueridge-2U-MRW.xml"
       help
           The name of the MRW XML file. Note that this file MUST
           come with the '.xml' prefix (all lowercase)

config BR2_BLUERIDGE_2U_XML_SYSTEM_FILENAME
        string "Targeting Blueridge 2U system xml filename"
        default ""
        help
            Defines the name of the system XML filename
            to be used when creating targeting binary image

config BR2_BLUERIDGE_2U_XML_TARGETING_FILENAME
        string "Targeting Blueridge 2U mrw xml filename"
        default ""
        help
            Defines the name of the mrw XML filename
            to be used when creating targeting binary image

config BR2_BLUERIDGE_2U_XML_TARGETING_BIN_FILENAME
        string "Name of the openpower binary targeting file"
        default "Blueridge-2U-MRW.targeting.bin"
        help
            String used to define name of openpower targeting binary file

config BR2_BLUERIDGE_2U_XML_TARGETING_ECC_FILENAME
        string "Name of the openpower binary targeting ecc file"
        default "Blueridge-2U-MRW.targeting.bin.ecc"
        help
            String used to define name of openpower
            targeting binary file, ecc protected

endif

endmenu
```
