## openpower/package/nvme/Config.in
```kconfig
config BR2_PACKAGE_NVME
	bool "nvme"
	help
	  System utilities for IBM Power NVME devices

	  https://github.com/linux-nvme/nvme-cli
```

## openpower/package/occ-p10/Config.in
```kconfig
config BR2_PACKAGE_OCC_P10
        bool "OCC (POWER10)"
        default y if (BR2_OPENPOWER_PLATFORM && BR2_OPENPOWER_POWER10)
        select BR2_CPP
        help
            Project to build OCC for P10

if BR2_PACKAGE_OCC_P10

config BR2_OCC_P10_BIN_FILENAME
        string "Name of P10 OCC image file"
	default "occ.bin"
        help
            String used to define name of the P10 OCC binary image file

config BR2_OCC_P10_GPU_BIN_BUILD
        bool "Enables Compilation of P10 GPU Binary Image"
        default n
        select BR2_PACKAGE_HOSTBOOT_BINARIES
        help
            Boolean used to flag whether to compile P10 OCC GPU binary

config BR2_OCC_P10_GPU_GPE_BIN_FILENAME
        string "Name of P10 OCC GPU GPE Binary file"
        help
            String used to define name of the P10 OCC GPUE GPE binary image file

choice
	prompt "P10 OCC version"
	default BR2_OCC_P10_LATEST_VERSION

config BR2_OCC_P10_LATEST_VERSION
	bool "Use latest P10 OCC master"

config BR2_OCC_P10_CUSTOM_VERSION
	bool "Custom P10 OCC version"

endchoice

config BR2_OCC_P10_CUSTOM_VERSION_VALUE
	string "P10 OCC version"
	depends on BR2_OCC_P10_CUSTOM_VERSION

config BR2_OCC_P10_VERSION
	string
	default "1bbd0c01980e27f51a7c15c71f5bd72d0e5efe3d" if BR2_OCC_P10_LATEST_VERSION
	default BR2_OCC_P10_CUSTOM_VERSION_VALUE \
		if BR2_OCC_P10_CUSTOM_VERSION

endif
```

## openpower/package/occ-p11/Config.in
```kconfig
config BR2_PACKAGE_OCC_P11
        bool "OCC (POWER11)"
        default y if (BR2_OPENPOWER_PLATFORM && BR2_OPENPOWER_POWER11)
        select BR2_CPP
        help
            Project to build OCC for P11

if BR2_PACKAGE_OCC_P11

config BR2_OCC_P11_BIN_FILENAME
        string "Name of P11 OCC image file"
	default "occ.bin"
        help
            String used to define name of the P11 OCC binary image file

config BR2_OCC_P11_GPU_BIN_BUILD
        bool "Enables Compilation of P11 GPU Binary Image"
        default n
        select BR2_PACKAGE_HOSTBOOT_BINARIES
        help
            Boolean used to flag whether to compile P11 OCC GPU binary

config BR2_OCC_P11_GPU_GPE_BIN_FILENAME
        string "Name of P11 OCC GPU GPE Binary file"
        help
            String used to define name of the P11 OCC GPUE GPE binary image file

choice
	prompt "P11 OCC version"
	default BR2_OCC_P11_LATEST_VERSION

config BR2_OCC_P11_LATEST_VERSION
	bool "Use latest P11 OCC master"

config BR2_OCC_P11_CUSTOM_VERSION
	bool "Custom P11 OCC version"

endchoice

config BR2_OCC_P11_CUSTOM_VERSION_VALUE
	string "P11 OCC version"
	depends on BR2_OCC_P11_CUSTOM_VERSION

config BR2_OCC_P11_VERSION
	string
	default "de4399262a17b6423a9451df32304e6ff469b1c2" if BR2_OCC_P11_LATEST_VERSION
	default BR2_OCC_P11_CUSTOM_VERSION_VALUE \
		if BR2_OCC_P11_CUSTOM_VERSION

endif
```

## openpower/package/occ-p8/Config.in
```kconfig
config BR2_PACKAGE_OCC_P8
        bool "OCC for P8"
        default y if (BR2_OPENPOWER_PLATFORM && BR2_OPENPOWER_POWER8)
        select BR2_CPP
        help
            Project to build OCC

if BR2_PACKAGE_OCC_P8

config BR2_OCC_P8_BIN_FILENAME
        string "Name of OCC P8 image file"
	default "occ.bin"
        help
            String used to define name of the OCC binary image file

endif
```

## openpower/package/occ-p9/Config.in
```kconfig
config BR2_PACKAGE_OCC_P9
        bool "OCC for P9"
        default y if (BR2_OPENPOWER_PLATFORM && BR2_OPENPOWER_POWER9)
        select BR2_CPP
        help
            Project to build OCC

config BR2_OCC_P9_BIN_FILENAME
        string "Name of OCC P9 image file"
	default "occ.bin"
        help
            String used to define name of the OCC binary image file

config BR2_OCC_P9_GPU_BIN_BUILD
        bool "Enables Compilation of GPU Binary Image"
        default n
        help
            Boolean used to flag whether to compile OCC GPU binary

config BR2_OCC_P9_GPU_GPE_BIN_FILENAME
        string "Name of OCC GPU GPE Binary file"
        help
            String used to define name of the OCC GPUE GPE binary image file

if BR2_PACKAGE_OCC_P9
config BR2_PACKAGE_PROVIDES_OCC
        default "occ-p9"
endif
```

## openpower/package/occ/Config.in
```kconfig
config BR2_PACKAGE_OCC
        bool "OCC (POWER9)"
        default y if (BR2_OPENPOWER_PLATFORM && BR2_OPENPOWER_POWER9)
        depends on BR2_PACKAGE_HAS_PPE42_TOOLCHAIN
        select BR2_CPP
        help
            Project to build OCC

if BR2_PACKAGE_OCC

config BR2_OCC_BIN_FILENAME
        string "Name of OCC P9 image file"
	default "occ.bin"
        help
            String used to define name of the OCC binary image file

config BR2_OCC_GPU_BIN_BUILD
        bool "Enables Compilation of GPU Binary Image"
        default n
        select BR2_PACKAGE_HOSTBOOT_BINARIES
        help
            Boolean used to flag whether to compile OCC GPU binary

config BR2_OCC_GPU_GPE_BIN_FILENAME
        string "Name of OCC GPU GPE Binary file"
        help
            String used to define name of the OCC GPUE GPE binary image file

choice
	prompt "OCC version"
	default BR2_OCC_LATEST_VERSION

config BR2_OCC_LATEST_VERSION
	bool "Use latest OCC master"

config BR2_OCC_CUSTOM_VERSION
	bool "Custom OCC version"

endchoice

config BR2_OCC_CUSTOM_VERSION_VALUE
	string "OCC version"
	depends on BR2_OCC_CUSTOM_VERSION

config BR2_OCC_VERSION
	string
	default "ab4dc96fd6cf584c42bd0b45be25458c0e61ad63" if BR2_OCC_LATEST_VERSION
	default BR2_OCC_CUSTOM_VERSION_VALUE \
		if BR2_OCC_CUSTOM_VERSION

endif
```

## openpower/package/ocmb-explorer-fw/Config.in
```kconfig
config BR2_PACKAGE_OCMB_EXPLORER_FW
        bool "ocmb-explorer-fw"
        default n
        help
            Project to stage ocmb explorer fw and binary image releases

if BR2_PACKAGE_OCMB_EXPLORER_FW

config BR2_OCMB_EXPLORER_FW_VERSION
	string
	default "CL444714"

config BR2_OCMB_EXPLORER_FW_SITE
        string
        default "https://github.com/open-power/ocmb-explorer-fw/releases/download/CL444714"

config BR2_OCMB_EXPLORER_FW_SOURCE
        string
        default "FW444714BinaryOnly.zip"

endif
```

## openpower/package/op-image-tools/Config.in
```kconfig
config BR2_PACKAGE_OP_IMAGE_TOOLS
    bool "op-image-tools"
    depends on (BR2_PACKAGE_OPENPOWER_PNOR_P10 || BR2_PACKAGE_OPENPOWER_PNOR_P11)
    select BR2_PACKAGE_HOST_PYTHON3
    select BR2_PACKAGE_HOST_PYTHON3_SSL
    help
        OpenPOWER Image Tools package.

config BR2_OP_IMAGE_TOOLS_VERSION
    string
    default "a6f83cd541b961b015ade28c8000b329242f0787"
```

## openpower/package/op-test/Config.in
```kconfig
config BR2_PACKAGE_OP_TEST
        bool "op-test"
        default y if (BR2_OPENPOWER_PLATFORM)
        help
            Include op-test in the Host debug tools tarball.

if BR2_PACKAGE_OP_TEST

choice
	prompt "op-test version"
	default BR2_OP_TEST_LATEST_VERSION

config BR2_OP_TEST_LATEST_VERSION
	bool "Use latest op-test master"

config BR2_OP_TEST_CUSTOM_VERSION
	bool "Custom op-test version"

endchoice

config BR2_OP_TEST_CUSTOM_VERSION_VALUE
	string "op-test version"
	depends on BR2_OP_TEST_CUSTOM_VERSION

config BR2_OP_TEST_VERSION
	string
	default "df857a3d43fb85ff7529fff10ee1872f6ce4a6a9" if BR2_OP_TEST_LATEST_VERSION
	default BR2_OP_TEST_CUSTOM_VERSION_VALUE           if BR2_OP_TEST_CUSTOM_VERSION

endif
```

## openpower/package/openpower-ffs/Config.in
```kconfig
config BR2_PACKAGE_HOST_OPENPOWER_FFS
        bool "ffs"
        default y if (BR2_OPENPOWER_PLATFORM)
        help
            Utilites for building an 'ffs' image file.
```

## openpower/package/openpower-mrw/Config.in
```kconfig
config BR2_PACKAGE_OPENPOWER_MRW
        bool "Machine Readable Workbook (MRW) infrastructure"
        default y if BR2_PACKAGE_HOSTBOOT_P8
```

## openpower/package/openpower-pnor-p10/Config.in
```kconfig
config BR2_PACKAGE_OPENPOWER_PNOR_P10
        bool "openpower_pnor_p10"
        depends on (!BR2_OPENPOWER_PNOR)
        select BR2_TARGET_ROOTFS_INITRAMFS
        select BR2_PACKAGE_HOSTBOOT_P10
        select BR2_PACKAGE_HOSTBOOT_BINARIES
        select BR2_PACKAGE_SKIBOOT
        select BR2_PACKAGE_OPENPOWER_FFS
        select BR2_PACKAGE_OCC_P10
        select BR2_PACKAGE_IMA_CATALOG
        select BR2_PACKAGE_HOST_OPENPOWER_VPNOR
        select BR2_PACKAGE_RAINIER_2U_XML
        select BR2_PACKAGE_RAINIER_4U_XML
        select BR2_PACKAGE_HCODE_P10
        help
            Utilites for building a targeting Power10 binary image

menu "OpenPOWER PNOR P10 assembly options"

choice
    prompt "Secure Boot key transition type"
    default BR2_OPENPOWER_P10_SECUREBOOT_NO_KEY_TRANSITION

config BR2_OPENPOWER_P10_SECUREBOOT_NO_KEY_TRANSITION
    bool "None"
    help
      Builds a driver that does not transition Secure Boot keys

config BR2_OPENPOWER_P10_SECUREBOOT_KEY_TRANSITION_TO_DEV
    bool "Transition existing keys to development keys"
    help
      Builds a driver that transitions Secure Boot keys to development keys and
      powers off the system.  Only usable when system security has been
      disabled.

config BR2_OPENPOWER_P10_SECUREBOOT_KEY_TRANSITION_TO_PROD
    bool "Transition development keys to production keys"
    help
      Builds a driver that transitions Secure Boot development keys to
      vendor supplied production keys and powers off the system.

endchoice

config BR2_OPENPOWER_P10_SECUREBOOT_SIGN_MODE
        string "Secureboot signing mode"
        default "development"
        help
            Available options [development | production]
            Indicates the signing mode when generating the PNOR image.  Only
            applicable when hostboot is compiled with SECUREBOOT compile flag.
            Default mode is development.

config BR2_OPENPOWER_P10_PNOR_XML_LAYOUT_FILENAME
        string "Name of Openpower pnor xml layout file"
        help
            String used to define hw specific make config file

config BR2_OPENPOWER_PNOR_P10_LEGACY_PNOR_TARGET
        string "Legacy name of P10 PNOR Configuration"
        help
            String used to define Legacy configuration name, used for
            building legacy PNOR-related binaries and intermediate files

config BR2_OPENPOWER_P10_XMLS
        string "List of machine XMLs to include"
        default "rainier-2u-xml rainier-4u-xml"
        help
            List of machine-xmls to include in the OpenPower PNOR

config BR2_SKIBOOT_P10_LID_NAME
        string "Name of skiboot lid name to be used"
        default "skiboot.lid"
        help
            String used to define skiboot lid filename

config BR2_HOSTBOOT_P10_BINARY_SBE_FILENAME
        string "Name of sbe hostboot binary"
        help
            String used to define name of sbe hostboot binary file

config BR2_HOSTBOOT_P10_BINARY_SBEC_FILENAME
        string "Name of sbec hostboot binary"
        help
            String used to define name of sbec hostboot binary file

config BR2_HOSTBOOT_P10_BINARY_IONV_FILENAME
        string "Name of IONV binary"
        default "ionv.bin"
        help
            String used to define name of ionv binary file

config BR2_HOSTBOOT_P10_BINARY_WINK_FILENAME
        string "Name of winkle hostboot binary"
        help
            String used to define name of winkle hostboot binary file

config BR2_IMA_CATALOG_P10_FILENAME
        string "Name of IMA catalog binary"
        help
            String used to define name of IMA catalog binary file

config BR2_IMA_CATALOG_P10_ECC_FILENAME
        string "Name of IMA catalog binary"
        help
            String used to define name of IMA catalog binary file, ecc protected

config BR2_OCMBFW_P10_FILENAME
        string "Name of the OCMBFW Update original file"
        default "signed_app_fw.mem"
        help
            String used to define name of OCBMFW Update original file (before any processing occurs)

config BR2_OCMBFW_P10_PROCESSED_FILENAME
        string "Name of OCMBFW Update binary processed file"
        default "ocmbfw.bin.ecc"
        help
            String used to define the name of the OCMBFW update binary file after processing, ecc protected

config BR2_OPENPOWER_SIGNED_SECURITY_VERSION
        string "Security Version to be included in signed partitions"
        help
            String used to define the security version to be included in signed partition

endmenu
```
