## openpower/package/openpower-pnor-p11/Config.in
```kconfig
config BR2_PACKAGE_OPENPOWER_PNOR_P11
        bool "openpower_pnor_p11"
        depends on (!BR2_OPENPOWER_PNOR)
        select BR2_TARGET_ROOTFS_INITRAMFS
        select BR2_PACKAGE_HOSTBOOT_P11
        select BR2_PACKAGE_HOSTBOOT_BINARIES
        select BR2_PACKAGE_SKIBOOT
        select BR2_PACKAGE_OPENPOWER_FFS
        select BR2_PACKAGE_OCC_P11
        select BR2_PACKAGE_IMA_CATALOG
        select BR2_PACKAGE_HOST_OPENPOWER_VPNOR
        select BR2_PACKAGE_RAINIER_2U_XML
        select BR2_PACKAGE_RAINIER_4U_XML
        select BR2_PACKAGE_EVEREST_XML
        select BR2_PACKAGE_HCODE_P11
        select BR2_PACKAGE_BONNELL_XML
        select BR2_PACKAGE_FUJI_XML
        select BR2_PACKAGE_BLUERIDGE_2U_XML
        select BR2_PACKAGE_BLUERIDGE_4U_XML
        help
            Utilites for building a targeting Power11 binary image

menu "OpenPOWER PNOR P11 assembly options"

choice
    prompt "Secure Boot key transition type"
    default BR2_OPENPOWER_P11_SECUREBOOT_NO_KEY_TRANSITION

config BR2_OPENPOWER_P11_SECUREBOOT_NO_KEY_TRANSITION
    bool "None"
    help
      Builds a driver that does not transition Secure Boot keys

config BR2_OPENPOWER_P11_SECUREBOOT_KEY_TRANSITION_TO_DEV
    bool "Transition existing keys to development keys"
    help
      Builds a driver that transitions Secure Boot keys to development keys and
      powers off the system.  Only usable when system security has been
      disabled.

config BR2_OPENPOWER_P11_SECUREBOOT_KEY_TRANSITION_TO_PROD
    bool "Transition development keys to production keys"
    help
      Builds a driver that transitions Secure Boot development keys to
      vendor supplied production keys and powers off the system.

endchoice

config BR2_OPENPOWER_P11_SECUREBOOT_SIGN_MODE
        string "Secureboot signing mode"
        default "development"
        help
            Available options [development | production]
            Indicates the signing mode when generating the PNOR image.  Only
            applicable when hostboot is compiled with SECUREBOOT compile flag.
            Default mode is development.

config BR2_OPENPOWER_P11_PNOR_XML_LAYOUT_FILENAME
        string "Name of Openpower pnor xml layout file"
        help
            String used to define hw specific make config file

config BR2_OPENPOWER_PNOR_P11_LEGACY_PNOR_TARGET
        string "Legacy name of P11 PNOR Configuration"
        help
            String used to define Legacy configuration name, used for
            building legacy PNOR-related binaries and intermediate files

config BR2_OPENPOWER_P11_XMLS
        string "List of machine XMLs to include"
        default "rainier-2u-xml rainier-4u-xml everest-xml bonnell-xml blueridge-2u-xml blueridge-4u-xml fuji-xml"
        help
            List of machine-xmls to include in the OpenPower PNOR

config BR2_SKIBOOT_P10_LID_NAME
        string "Name of skiboot lid name to be used"
        default "skiboot.lid"
        help
            String used to define skiboot lid filename

config BR2_HOSTBOOT_P11_BINARY_SBE_FILENAME
        string "Name of sbe hostboot binary"
        help
            String used to define name of sbe hostboot binary file

#config BR2_HOSTBOOT_P11_BINARY_SBEC_FILENAME
#        string "Name of sbec hostboot binary"
#        help
#            String used to define name of sbec hostboot binary file

#config BR2_HOSTBOOT_P11_BINARY_IONV_FILENAME
#        string "Name of IONV binary"
#        default "ionv.bin"
#        help
#            String used to define name of ionv binary file

config BR2_HOSTBOOT_P11_BINARY_WINK_FILENAME
        string "Name of winkle hostboot binary"
        help
            String used to define name of winkle hostboot binary file

config BR2_IMA_CATALOG_P11_FILENAME
        string "Name of IMA catalog binary"
        help
            String used to define name of IMA catalog binary file

config BR2_IMA_CATALOG_P11_ECC_FILENAME
        string "Name of IMA catalog binary"
        help
            String used to define name of IMA catalog binary file, ecc protected

config BR2_OCMBFW_P11_FILENAME
        string "Name of the OCMBFW Update original file"
        default "signed_app_fw.mem"
        help
            String used to define name of OCBMFW Update original file (before any processing occurs)

config BR2_OCMBFW_P11_PROCESSED_FILENAME
        string "Name of OCMBFW Update binary processed file"
        default "ocmbfw.bin.ecc"
        help
            String used to define the name of the OCMBFW update binary file after processing, ecc protected

config BR2_OPENPOWER_SIGNED_SECURITY_VERSION
        string "Security Version to be included in signed partitions"
        help
            String used to define the security version to be included in signed partition

endmenu
```

## openpower/package/openpower-pnor/Config.in
```kconfig
config BR2_PACKAGE_OPENPOWER_PNOR
        bool "openpower_pnor"
        default y if (BR2_OPENPOWER_PLATFORM)
        select BR2_PACKAGE_HOSTBOOT
        select BR2_PACKAGE_HOSTBOOT_BINARIES
        select BR2_PACKAGE_SKIBOOT
        select BR2_PACKAGE_OPENPOWER_FFS
        select BR2_PACKAGE_OCC
        select BR2_PACKAGE_CAPP_UCODE
        select BR2_PACKAGE_IMA_CATALOG
        select BR2_PACKAGE_HOST_OPENPOWER_VPNOR
        select BR2_PACKAGE_MACHINE_XML
        select BR2_PACKAGE_HCODE if BR2_OPENPOWER_POWER9
        help
            Utilites for building a targeting binary image

menu "OpenPOWER PNOR assembly options"

choice
    prompt "Secure Boot key transition type"
    default BR2_OPENPOWER_SECUREBOOT_NO_KEY_TRANSITION

config BR2_OPENPOWER_SECUREBOOT_NO_KEY_TRANSITION
    bool "None"
    help
      Builds a driver that does not transition Secure Boot keys

config BR2_OPENPOWER_SECUREBOOT_KEY_TRANSITION_TO_DEV
    bool "Transition existing keys to development keys"
    help
      Builds a driver that transitions Secure Boot keys to development keys and
      powers off the system.  Only usable when system security has been
      disabled.

config BR2_OPENPOWER_SECUREBOOT_KEY_TRANSITION_TO_PROD
    bool "Transition development keys to production keys"
    help
      Builds a driver that transitions Secure Boot development keys to
      vendor supplied production keys and powers off the system.

endchoice

config BR2_OPENPOWER_SECUREBOOT_SIGN_MODE
        string "Secureboot signing mode"
        default "development"
        help
            Available options [development | production]
            Indicates the signing mode when generating the PNOR image.  Only
            applicable when hostboot is compiled with SECUREBOOT compile flag.
            Default mode is development.

config BR2_OPENPOWER_PNOR_XML_LAYOUT_FILENAME
        string "Name of Openpower pnor xml layout file"
        help
            String used to define hw specific make config file

config BR2_OPENPOWER_CONFIG_NAME
        string "Name of configuration"
        help
            String used to define configuration name

config BR2_OPENPOWER_PNOR_FILENAME
        string "Name of pnor file to be created"
        help
            String used to define pnor filename to be created

config BR2_OPENPOWER_PNOR_UPDATE_FILENAME
        string "Name of pnor file to be created for updates, if needed"
        help
            String used to define pnor filename to be created for updates, if needed

config BR2_SKIBOOT_LID_NAME
        string "Name of skiboot lid name to be used"
        default "skiboot.lid"
        help
            String used to define skiboot lid filename

config BR2_TARGET_SKIBOOT_XZ
        bool "Compress the skiboot image with XZ"
        select BR2_OPENPOWER_PNOR_XZ_ENABLED
        default y

config BR2_SKIBOOT_LID_XZ_NAME
        string "Name of compressed skiboot lid"
        default "skiboot.lid" if !BR2_TARGET_SKIBOOT_XZ
        default "skiboot.lid.xz" if BR2_TARGET_SKIBOOT_XZ
        help
            String used to define compressed skiboot lid filename

config BR2_HOSTBOOT_BINARY_SBE_FILENAME
        string "Name of sbe hostboot binary"
        help
            String used to define name of sbe hostboot binary file

config BR2_HOSTBOOT_BINARY_SBEC_FILENAME
        string "Name of sbec hostboot binary"
        help
            String used to define name of sbec hostboot binary file

config BR2_HOSTBOOT_BINARY_IONV_FILENAME
        string "Name of IONV binary"
        default "ionv.bin"
        help
            String used to define name of ionv binary file

config BR2_HOSTBOOT_BINARY_WINK_FILENAME
        string "Name of winkle hostboot binary"
        help
            String used to define name of winkle hostboot binary file

config BR2_WOFDATA_FILENAME
        string "Name of wofdata original file"
        default "wof_output"
        help
            String used to define name of wofdata original file

config BR2_WOFDATA_BINARY_FILENAME
        string "Name of wofdata binary file"
        default "wofdata.bin.ecc"
        help
            String used to define name of wofdata binary ecc'd file

config BR2_MEMDDATA_FILENAME
        string "Name of memd original file"
        default "memd_output.dat"
        help
            String used to define name of memd original file

config BR2_MEMDDATA_BINARY_FILENAME
        string "Name of memd binary file"
        default "memd_extra_data.bin.ecc"
        help
            String used to define the name of the memd binary ecc'd file

config BR2_IMA_CATALOG_FILENAME
        string "Name of IMA catalog binary"
        help
            String used to define name of IMA catalog binary file

config BR2_IMA_CATALOG_ECC_FILENAME
        string "Name of IMA catalog binary"
        help
            String used to define name of IMA catalog binary file, ecc protected

config BR2_OPENPOWER_TARGETING_BIN_FILENAME
        string "Name of openpower binary targeting file"
        help
            String used to define name of openpower targeting binary file

config BR2_OPENPOWER_TARGETING_ECC_FILENAME
        string "Name of openpower binary targeting file"
        help
            String used to define name of openpower targeting binary file, ecc protected

config BR2_OCMBFW_FILENAME
        string "Name of the OCMBFW Update original file"
        default "signed_app_fw.mem"
        help
            String used to define name of OCBMFW Update original file (before any processing occurs)

config BR2_OCMBFW_PROCESSED_FILENAME
        string "Name of OCMBFW Update binary processed file"
        default "ocmbfw.bin.ecc"
        help
            String used to define the name of the OCMBFW update binary file after processing, ecc protected

config BR2_OPENPOWER_PNOR_XZ_ENABLED
        bool "Enable xz compression in PNOR payloads"
        default n

config BR2_BUILD_PNOR_SQUASHFS
        bool "Create a virtual PNOR image along with the standard image"
        default n

endmenu
```

## openpower/package/openpower-targeting/Config.in
```kconfig
config BR2_PACKAGE_OPENPOWER_TARGETING
        bool "openpower_targeting"
        default y if (BR2_OPENPOWER_PLATFORM && BR2_powerpc_power8)
        help
            Utilites for building a targeting binary image

config BR2_OPENPOWER_TARGETING_BIN_FILENAME
        string "openpower targeting binary file name"
        default ""
        help
            Defines targeting binary file name created

config BR2_OPENPOWER_TARGETING_ECC_FILENAME
        string "openpower targeting binary file name - ecc injected"
        default ""
        help
            Defines targeting binary ecc file name created

config BR2_OPENPOWER_TARGETING_SYSTEM_XML_FILENAME
        string "openpower targeting system xml filename"
        default ""
        help
            Defines the name of the system XML filename to be used when creating targeting binary image

config BR2_OPENPOWER_TARGETING_MRW_XML_FILENAME
        string "openpower targeting mrw xml filename"
        default ""
        help
            Defines the name of the mrw XML filename to be used when creating targeting binary image
```

## openpower/package/p8-pore-binutils/Config.in
```kconfig
config BR2_PACKAGE_HOST_P8_PORE_BINUTILS
        bool "p8-pore-binutils"
        select BR2_PACKAGE_HAS_P8_PORE_TOOLCHAIN
        select BR2_CPP
        help
            Project to build the P8 PORE binutils

if BR2_PACKAGE_HOST_P8_PORE_BINUTILS
config BR2_PACKAGE_PROVIDES_P8_PORE_TOOLCHAIN
        default "p8-pore-binutils"
endif
```

## openpower/package/p8-pore-toolchain-external/Config.in
```kconfig
config BR2_PACKAGE_P8_PORE_TOOLCHAIN_EXTERNAL
	bool "p8-pore-toolchain-external"
	select BR2_PACKAGE_HAS_P8_PORE_TOOLCHAIN
	help
	  Use an external P8 PORE toolchain

if BR2_PACKAGE_P8_PORE_TOOLCHAIN_EXTERNAL
config BR2_PACKAGE_PROVIDES_P8_PORE_TOOLCHAIN
	default "p8-pore-toolchain-external"

config BR2_P8_PORE_TOOLCHAIN_EXTERNAL_PATH
	string "External P8 PORE toolchain path"
	help
	  Pathname to where the external P8 PORE toolchain
	  is installed. The binutils are expected to be
	  fully contained within the
	  "sysroot/p8-pore-toolchain" directory
endif
```

## openpower/package/p9dsu-xml/Config.in
```kconfig
config BR2_PACKAGE_P9DSU_XML
        bool "p9dsu_xml"
        default y if (BR2_OPENPOWER_CONFIG_NAME = "p9dsu")
        help
            Utilites for building xml and the targeting binary image

config BR2_P9DSU_SYSTEM_XML_FILENAME
        string "Witherspoon targeting system xml filename"
        default ""
        help
            Defines the name of the system XML filename to be used when creating targeting binary image

config BR2_P9DSU_MRW_XML_FILENAME
        string "Witherspoon targeting mrw xml filename"
        default ""
        help
            Defines the name of the mrw XML filename to be used when creating targeting binary image

config BR2_P9DSU_BIOS_XML_FILENAME
        string "Witherspoon BIOS metadata XML filename"
        default ""
        help
            Defines the name of the BIOS XML filename to parse when generating BIOS metadata
```

## openpower/package/p9so_sim-xml/Config.in
```kconfig
config BR2_PACKAGE_P9SO_SIM_XML
        bool "p9so_sim_xml"
        default y if (BR2_OPENPOWER_CONFIG_NAME = "p9so_sim")
        help
            Utilites for building xml and the targeting binary image

config BR2_P9SO_SIM_SYSTEM_XML_FILENAME
        string "p9so_sim targeting system xml filename"
        default ""
        help
            Defines the name of the system XML filename to be used when creating targeting binary image

config BR2_P9SO_SIM_MRW_XML_FILENAME
        string "p9so_sim targeting mrw xml filename"
        default ""
        help
            Defines the name of the mrw XML filename to be used when creating targeting binary image

config BR2_P9SO_SIM_BIOS_XML_FILENAME
        string "p9so_sim BIOS metadata XML filename"
        default ""
        help
            Defines the name of the BIOS XML filename to parse when generating BIOS metadata
```

## openpower/package/palmetto-xml/Config.in
```kconfig
config BR2_PACKAGE_PALMETTO_XML
        bool "palmetto_xml"
        default y if (BR2_OPENPOWER_CONFIG_NAME = "palmetto")
        help
            Utilites for building xml and the targeting binary image

config BR2_PALMETTO_SYSTEM_XML_FILENAME
        string "Palmetto targeting system xml filename"
        default ""
        help
            Defines the name of the system XML filename to be used when creating targeting binary image

config BR2_PALMETTO_MRW_XML_FILENAME
        string "Palmetto targeting mrw xml filename"
        default ""
        help
            Defines the name of the mrw XML filename to be used when creating targeting binary image
```
