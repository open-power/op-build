## openpower/package/pdata/Config.in
```kconfig
menu "pdata"

config BR2_PACKAGE_PDATA
        bool "pdata"
        default y if (BR2_OPENPOWER_POWER10)
        select BR2_PACKAGE_HOST_DTC
        depends on BR2_PACKAGE_EKB
        depends on (BR2_PACKAGE_MACHINE_XML || BR2_PACKAGE_RAINIER_2U_XML || BR2_PACKAGE_RAINIER_4U_XML)
        help
          To initialize and boot a server, various software components
          ( BMC apps and Hostboot) will interact. PDATA provides device tree
          based infrastructure to get the attributes which are required
          to boot the server and run time usage. Also provides API's
          to manage the attributes data.

if BR2_PACKAGE_PDATA

choice
    prompt "PDATA location"

config BR2_PDATA_GITHUB_PROJECT
    bool "PDATA located at default Github project"

config BR2_PDATA_CUSTOM_GIT
    bool "PDATA located at Custom Git repository"

endchoice

config BR2_PDATA_CUSTOM_GIT_VALUE
    string "URL of PDATA Custom Git repository"

choice
    prompt "PDATA version"
    default BR2_PDATA_LATEST_VERSION

config BR2_PDATA_LATEST_VERSION
    bool "Use latest PDATA master"

config BR2_PDATA_CUSTOM_VERSION
    bool "Custom PDATA version"

endchoice

config BR2_PDATA_CUSTOM_VERSION_VALUE
    string "PDATA version"
    depends on BR2_PDATA_CUSTOM_VERSION

config BR2_PDATA_VERSION
    string
    default "c6fe397485a2c2c819464a2bdb9f0dc967752c7d" if BR2_PDATA_LATEST_VERSION
    default BR2_PDATA_CUSTOM_VERSION_VALUE if BR2_PDATA_CUSTOM_VERSION

endif

endmenu
```

## openpower/package/perl-class-errorhandler/Config.in
```kconfig
config BR2_PACKAGE_PERL_CLASS_ERRORHANDLER
	bool "perl-class-errorhandler"
	help
	  Base class for error handling

	  https://github.com/tokuhirom/Class-ErrorHandler
```

## openpower/package/perl-convert-pem/Config.in
```kconfig
config BR2_PACKAGE_PERL_CONVERT_PEM
	bool "perl-convert-pem"
	default y if (BR2_PACKAGE_HOST_SB_SIGNING_UTILS)
	select BR2_PACKAGE_PERL_CLASS_ERRORHANDLER
	select BR2_PACKAGE_PERL_CONVERT_ASN1
	select BR2_PACKAGE_PERL_CRYPT_DES_EDE3
	help
	  Read/write encrypted ASN.1 PEM files

	  https://metacpan.org/release/Convert-PEM
```

## openpower/package/perl-crypt-des-ede3/Config.in
```kconfig
config BR2_PACKAGE_PERL_CRYPT_DES_EDE3
	bool "perl-crypt-des-ede3"
	help
	  Triple-DES EDE encryption/decryption

	  https://metacpan.org/release/Crypt-DES_EDE3
```

## openpower/package/petitboot/Config.in
```kconfig
config BR2_PACKAGE_PETITBOOT
	bool "petitboot"
	# petitboot needs udev /dev management
	depends on BR2_PACKAGE_HAS_UDEV
	select BR2_PACKAGE_LVM2
	select BR2_PACKAGE_NCURSES
	select BR2_PACKAGE_NCURSES_TARGET_PANEL
	select BR2_PACKAGE_NCURSES_TARGET_FORM
	select BR2_PACKAGE_NCURSES_TARGET_MENU
	# run-time dependency only
	select BR2_PACKAGE_KEXEC_LITE if !BR2_PACKAGE_KEXEC
	# run-time dependency only
	select BR2_PACKAGE_POWERPC_UTILS if BR2_powerpc || BR2_powerpc64 || BR2_powerpc64le
	# run-time dependency only
	select BR2_PACKAGE_NVME if BR2_powerpc || BR2_powerpc64 || BR2_powerpc64le
	help
	  Petitboot is a small kexec-based bootloader

	  http://www.kernel.org/pub/linux/kernel/people/geoff/petitboot/petitboot.html

comment "petitboot requires udev to be enabled"
	depends on !BR2_PACKAGE_HAS_UDEV

config BR2_PACKAGE_PETITBOOT_MTD
	bool "petitboot-mtd"
	depends on BR2_PACKAGE_PETITBOOT
	select BR2_PACKAGE_LIBFLASH
	select BR2_PACKAGE_PFLASH
	help
	  Adds Petitboot support for MTD devices

comment "Add support for accessing MTD devices"
```
