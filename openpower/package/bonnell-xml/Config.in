## openpower/package/bonnell-xml/Config.in
```kconfig
menu "Bonnell XML (MRW)"

config BR2_PACKAGE_BONNELL_XML
        bool "bonnell_xml"

if BR2_PACKAGE_BONNELL_XML

choice
	prompt "Bonnell XML location"

config BR2_BONNELL_XML_GITHUB_PROJECT
       bool "OpenPOWER Github project name"

config BR2_BONNELL_XML_CUSTOM_GIT
       bool "Custom URL of Bonnell xml repository"

endchoice

config BR2_BONNELL_XML_FILTER_UNWANTED_ATTRIBUTES
       bool "Filter Unwanted Attributes"
       default y

config BR2_BONNELL_XML_OPPOWERVM_ATTRIBUTES
       bool "OPPOWERVM Attributes/Target"
       default y

config BR2_BONNELL_XML_TARGET_TYPES_OPENPOWER_XML
       bool "Include target_types_openpower.xml"
       default y

config BR2_BONNELL_XML_CUSTOM_GIT_VALUE
	string "URL of Bonnell xml repository"
	depends on BR2_BONNELL_XML_CUSTOM_GIT

config BR2_BONNELL_XML_GITHUB_PROJECT_VALUE
       string "The Github project name (e.g. bonnell-xml)"
       default "bonnell-xml"
       depends on BR2_BONNELL_XML_GITHUB_PROJECT

config BR2_BONNELL_XML_VERSION
       string "Version of Bonnell XML"

config BR2_BONNELL_XML_FILENAME
       string "Bonnell XML filename (e.g. bonnell-mrw.xml)"
       default "bonnell-mrw.xml"
       help
           The name of the MRW XML file. Note that this file MUST
           come with the '.xml' prefix (all lowercase)

config BR2_BONNELL_XML_SYSTEM_FILENAME
       string "Targeting Bonnell system xml filename"
       default ""
       help
           Defines the name of the system XML filename
           to be used when creating targeting binary image

config BR2_BONNELL_XML_TARGETING_FILENAME
       string "Targeting Bonnell mrw xml filename"
       default ""
       help
           Defines the name of the mrw XML filename
           to be used when creating targeting binary image

config BR2_BONNELL_XML_BIOS_FILENAME
       string "BIOS Bonnell metadata XML filename"
       default "Bonnell-MRW_bios.xml"
       help
           Defines the name of the BIOS XML filename
           to parse when generating BIOS metadata

config BR2_BONNELL_XML_TARGETING_BIN_FILENAME
       string "Name of the openpower binary targeting file"
       default "Bonnell-MRW.targeting.bin"
       help
           String used to define name of openpower targeting binary file

config BR2_BONNELL_XML_TARGETING_ECC_FILENAME
       string "Name of the openpower binary targeting ecc file"
       default "Bonnell-MRW.targeting.bin.ecc"
       help
           String used to define name of openpower
           targeting binary file, ecc protected

endif

endmenu
```

## openpower/package/capp-ucode/Config.in
```kconfig
config BR2_PACKAGE_CAPP_UCODE
        bool "capp_capp"
        default y if (BR2_OPENPOWER_PLATFORM)
        help
            Microcode for CAPP hardware

config BR2_CAPP_UCODE_BIN_FILENAME
        string "Name of CAPP UCODE image file"
        help
            String used to define name of the CAPP UCODE binary image file
```

## openpower/package/common-p8-xml/Config.in
```kconfig
config BR2_PACKAGE_COMMON_P8_XML
        bool "Common P8 XML files"
        default y if BR2_PACKAGE_HOSTBOOT_P8
        select BR2_PACKAGE_OPENPOWER_MRW
```

## openpower/package/devicetree/Config.in
```kconfig
config BR2_PACKAGE_DEVICETREE
	bool "Device tree"

if BR2_PACKAGE_DEVICETREE

config BR2_DEVICETREE_SOURCE
	string "Device tree source"

endif
```

## openpower/package/ekb/Config.in
```kconfig
menu "ekb"

config BR2_PACKAGE_EKB
        bool "ekb"
        default y if (BR2_OPENPOWER_POWER10)
        help
          To boot the server, the bmc application and hostboot will expect
          hardware functional details which are maintained in xml files by ekb.
          So, this packge is used to get all those xml files and pdata will
          consume those xml files to add hardware functional details into
          device tree.

if BR2_PACKAGE_EKB

choice
    prompt "EKB version"
    default BR2_EKB_LATEST_VERSION

config BR2_EKB_LATEST_VERSION
    bool "Use latest EKB master"

config BR2_EKB_CUSTOM_VERSION
    bool "Custom EKB version"

endchoice

config BR2_EKB_CUSTOM_VERSION_VALUE
    string "EKB version"
    depends on BR2_EKB_CUSTOM_VERSION

config BR2_EKB_VERSION
    string
    default "92cd4018f6d81f8bd8a47e626845df20456e6458" if BR2_EKB_LATEST_VERSION
    default BR2_EKB_CUSTOM_VERSION_VALUE if BR2_EKB_CUSTOM_VERSION
endif

endmenu
```

## openpower/package/everest-xml/Config.in
```kconfig
menu "Everest XML (MRW)"

config BR2_PACKAGE_EVEREST_XML
        bool "everest_xml"

if BR2_PACKAGE_EVEREST_XML

choice
	prompt "Everest XML location"

config BR2_EVEREST_XML_GITHUB_PROJECT
       bool "OpenPOWER Github project name"

config BR2_EVEREST_XML_CUSTOM_GIT
       bool "Custom URL of Everest xml repository"

endchoice

config BR2_EVEREST_XML_FILTER_UNWANTED_ATTRIBUTES
       bool "Filter Unwanted Attributes"
       default y

config BR2_EVEREST_XML_OPPOWERVM_ATTRIBUTES
       bool "OPPOWERVM Attributes/Target"
       default y

config BR2_EVEREST_XML_TARGET_TYPES_OPENPOWER_XML
       bool "Include target_types_openpower.xml"
       default y

config BR2_EVEREST_XML_CUSTOM_GIT_VALUE
	string "URL of Everest xml repository"
	depends on BR2_EVEREST_XML_CUSTOM_GIT

config BR2_EVEREST_XML_GITHUB_PROJECT_VALUE
       string "The Github project name (e.g. everest-xml)"
       default "everest-xml"
       depends on BR2_EVEREST_XML_GITHUB_PROJECT

config BR2_EVEREST_XML_VERSION
       string "Version of Everest XML"

config BR2_EVEREST_XML_FILENAME
       string "Everest XML filename (e.g. Everest-MRW.xml)"
       default "Everest-MRW.xml"
       help
           The name of the MRW XML file. Note that this file MUST
           come with the '.xml' prefix (all lowercase)

config BR2_EVEREST_XML_SYSTEM_FILENAME
        string "Targeting Everest system xml filename"
        default ""
        help
            Defines the name of the system XML filename
            to be used when creating targeting binary image

config BR2_EVEREST_XML_TARGETING_FILENAME
        string "Targeting Everest mrw xml filename"
        default ""
        help
            Defines the name of the mrw XML filename
            to be used when creating targeting binary image

config BR2_EVEREST_XML_BIOS_FILENAME
        string "BIOS Everest metadata XML filename"
        default "Everest-MRW_bios.xml"
        help
            Defines the name of the BIOS XML filename
            to parse when generating BIOS metadata

config BR2_EVEREST_XML_TARGETING_BIN_FILENAME
        string "Name of the openpower binary targeting file"
        default "Everest-MRW.targeting.bin"
        help
            String used to define name of openpower targeting binary file

config BR2_EVEREST_XML_TARGETING_ECC_FILENAME
        string "Name of the openpower binary targeting ecc file"
        default "Everest-MRW.targeting.bin.ecc"
        help
            String used to define name of openpower
            targeting binary file, ecc protected

endif

endmenu
```

## openpower/package/firestone-xml/Config.in
```kconfig
config BR2_PACKAGE_FIRESTONE_XML
        bool "firestone_xml"
        default y if (BR2_OPENPOWER_CONFIG_NAME = "firestone")
        select BR2_PACKAGE_COMMON_P8_XML
        help
            Utilites for building xml and the targeting binary image

config BR2_FIRESTONE_SYSTEM_XML_FILENAME
        string "Firestone targeting system xml filename"
        default ""
        help
            Defines the name of the system XML filename to be used when creating targeting binary image

config BR2_FIRESTONE_MRW_XML_FILENAME
        string "Firestone targeting mrw xml filename"
        default ""
        help
            Defines the name of the mrw XML filename to be used when creating targeting binary image

config BR2_FIRESTONE_BIOS_XML_FILENAME
        string "Firestone BIOS metadata XML filename"
        default ""
        help
            Defines the name of the BIOS XML filename to parse when generating BIOS metadata
```

## openpower/package/fsp-trace/Config.in
```kconfig
config BR2_PACKAGE_FSP_TRACE
        bool "fsp_trace"
        default y if (BR2_OPENPOWER_PLATFORM)
        help
            Project to build fsp-trace tool

if BR2_PACKAGE_FSP_TRACE

choice
	prompt "FSP-Trace version"
	default BR2_FSP_TRACE_LATEST_VERSION

config BR2_FSP_TRACE_LATEST_VERSION
	bool "Use latest FSP_TRACE master"

config BR2_FSP_TRACE_CUSTOM_VERSION
	bool "Custom FSP_TRACE version"

endchoice

config BR2_FSP_TRACE_CUSTOM_VERSION_VALUE
	string "FSP_TRACE version"
	depends on BR2_FSP_TRACE_CUSTOM_VERSION

config BR2_FSP_TRACE_VERSION
	string
	default "cf0bd9b36c0d8cb091a471973493d1370330c7d1" if BR2_FSP_TRACE_LATEST_VERSION
	default BR2_FSP_TRACE_CUSTOM_VERSION_VALUE \
		if BR2_FSP_TRACE_CUSTOM_VERSION

endif
```

## openpower/package/garrison-xml/Config.in
```kconfig
config BR2_PACKAGE_GARRISON_XML
        bool "garrison_xml"
        default y if (BR2_OPENPOWER_CONFIG_NAME = "garrison")
        select BR2_PACKAGE_COMMON_P8_XML
        help
            Utilites for building xml and the targeting binary image

config BR2_GARRISON_SYSTEM_XML_FILENAME
        string "Garrison targeting system xml filename"
        default ""
        help
            Defines the name of the system XML filename to be used when creating targeting binary image

config BR2_GARRISON_MRW_XML_FILENAME
        string "Garrison targeting mrw xml filename"
        default ""
        help
            Defines the name of the mrw XML filename to be used when creating targeting binary image

config BR2_GARRISON_BIOS_XML_FILENAME
        string "Garrison BIOS metadata XML filename"
        default ""
        help
            Defines the name of the BIOS XML filename to parse when generating BIOS metadata
```

## openpower/package/habanero-xml/Config.in
```kconfig
config BR2_PACKAGE_HABANERO_XML
        bool "habanero_xml"
        default y if (BR2_OPENPOWER_CONFIG_NAME = "habanero")
        help
            Utilites for building xml and the targeting binary image

config BR2_HABANERO_SYSTEM_XML_FILENAME
        string "Habanero targeting system xml filename"
        default ""
        help
            Defines the name of the system XML filename to be used when creating targeting binary image

config BR2_HABANERO_MRW_XML_FILENAME
        string "Habanero targeting mrw xml filename"
        default ""
        help
            Defines the name of the mrw XML filename to be used when creating targeting binary image
```

## openpower/package/hcode-p10/Config.in
```kconfig
config BR2_PACKAGE_HCODE_P10
        bool "hcode-p10"
        default y if (BR2_OPENPOWER_PLATFORM && BR2_OPENPOWER_POWER10)
        select BR2_CPP
        help
            Project to build the HCODE package for P10

if BR2_PACKAGE_HCODE_P10

config BR2_HCODE_INCLUDE_IONV
        bool "Enables packaging of the NVIDIA GPU image into the final hw image"
        default y
        help
            Boolean used to flag whether to include NVIDIA GPU binary

choice
	prompt "HCODE version"
	default BR2_HCODE_P10_LATEST_VERSION

config BR2_HCODE_P10_LATEST_VERSION
	bool "Use latest HCODE P10 version"

config BR2_HCODE_P10_CUSTOM_VERSION
	bool "Custom HCODE P10 version"

endchoice

config BR2_HCODE_P10_CUSTOM_VERSION_VALUE
	string "HCODE P10 version"
	depends on BR2_HCODE_P10_CUSTOM_VERSION

config BR2_HCODE_P10_VERSION
	string
	default "hw020320a.opmst10" if BR2_HCODE_P10_LATEST_VERSION
	default BR2_HCODE_P10_CUSTOM_VERSION_VALUE \
		if BR2_HCODE_P10_CUSTOM_VERSION

endif
```

## openpower/package/hcode-p11/Config.in
```kconfig
config BR2_PACKAGE_HCODE_P11
        bool "hcode-p11"
        default y if (BR2_OPENPOWER_PLATFORM && BR2_OPENPOWER_POWER11)
        select BR2_CPP
        help
            Project to build the HCODE package for P11

if BR2_PACKAGE_HCODE_P11

config BR2_HCODE_INCLUDE_IONV
        bool "Enables packaging of the NVIDIA GPU image into the final hw image"
        default y
        help
            Boolean used to flag whether to include NVIDIA GPU binary

choice
	prompt "HCODE version"
	default BR2_HCODE_P11_LATEST_VERSION

config BR2_HCODE_P11_LATEST_VERSION
	bool "Use latest HCODE P11 version"

config BR2_HCODE_P11_CUSTOM_VERSION
	bool "Custom HCODE P11 version"

endchoice

config BR2_HCODE_P11_CUSTOM_VERSION_VALUE
	string "HCODE P11 version"
	depends on BR2_HCODE_P11_CUSTOM_VERSION

config BR2_HCODE_P11_VERSION
	string
	default "hw021525a.opmainp11" if BR2_HCODE_P11_LATEST_VERSION
	default BR2_HCODE_P11_CUSTOM_VERSION_VALUE \
		if BR2_HCODE_P11_CUSTOM_VERSION

endif
```

## openpower/package/hcode/Config.in
```kconfig
config BR2_PACKAGE_HCODE
        bool "hcode"
        default y if (BR2_OPENPOWER_PLATFORM && BR2_OPENPOWER_POWER9)
        depends on BR2_PACKAGE_HAS_PPE42_TOOLCHAIN
        select BR2_CPP
        select BR2_PACKAGE_HOSTBOOT_BINARIES
        help
            Project to build the hcode firmware codebase

if BR2_PACKAGE_HCODE

config BR2_HCODE_INCLUDE_IONV
        bool "Enables packaging of the NVIDIA GPU image into the final hw image"
        default y
        help
            Boolean used to flag whether to include NVIDIA GPU binary

choice
	prompt "HCODE version"
	default BR2_HCODE_LATEST_VERSION

config BR2_HCODE_LATEST_VERSION
	bool "Use latest HCODE master"

config BR2_HCODE_CUSTOM_VERSION
	bool "Custom HCODE version"

endchoice

config BR2_HCODE_CUSTOM_VERSION_VALUE
	string "HCODE version"
	depends on BR2_HCODE_CUSTOM_VERSION

config BR2_HCODE_VERSION
	string
	default "hw083020a.opmst" if BR2_HCODE_LATEST_VERSION
	default BR2_HCODE_CUSTOM_VERSION_VALUE \
		if BR2_HCODE_CUSTOM_VERSION

endif
```

## openpower/package/hostboot-binaries/Config.in
```kconfig
config BR2_PACKAGE_HOSTBOOT_BINARIES
        bool "hostboot_binaries"
        default y if (BR2_OPENPOWER_PLATFORM)
        help
            Project to stage hostboot binary images

if BR2_PACKAGE_HOSTBOOT_BINARIES

choice
	prompt "Hostboot-binaries version"
	default BR2_HOSTBOOT_BINARIES_LATEST_VERSION

config BR2_HOSTBOOT_BINARIES_LATEST_VERSION
	bool "Use latest HOSTBOOT_BINARIES master"

config BR2_HOSTBOOT_BINARIES_CUSTOM_VERSION
	bool "Custom HOSTBOOT_BINARIES version"

endchoice

config BR2_HOSTBOOT_BINARIES_CUSTOM_VERSION_VALUE
	string "HOSTBOOT_BINARIES version"
	depends on BR2_HOSTBOOT_BINARIES_CUSTOM_VERSION

config BR2_HOSTBOOT_BINARIES_VERSION
	string
	default "hw013120a.opmst" if BR2_HOSTBOOT_BINARIES_LATEST_VERSION
	default BR2_HOSTBOOT_BINARIES_CUSTOM_VERSION_VALUE \
		if BR2_HOSTBOOT_BINARIES_CUSTOM_VERSION

endif
```

## openpower/package/hostboot-p10/Config.in
```kconfig
config BR2_PACKAGE_HOSTBOOT_P10
        bool "hostboot-p10"
        default y if (BR2_OPENPOWER_POWER10)
        select BR2_CPP
        help
            Project to build the Hostboot package for P10

if BR2_PACKAGE_HOSTBOOT_P10

choice
	prompt "P10 Hostboot version"
	default BR2_HOSTBOOT_P10_LATEST_VERSION

config BR2_HOSTBOOT_P10_LATEST_VERSION
	bool "Use latest Hostboot version"

config BR2_HOSTBOOT_P10_CUSTOM_VERSION
	bool "Use custom Hostboot version"

endchoice

config BR2_HOSTBOOT_P10_CUSTOM_VERSION_VALUE
	string "Hostboot P10 version"
	depends on BR2_HOSTBOOT_P10_CUSTOM_VERSION

config BR2_HOSTBOOT_P10_VERSION
	string
	default "6ca9e64f9a3467417c42caa5dd88adc3210cfff8" if BR2_HOSTBOOT_P10_LATEST_VERSION
	default BR2_HOSTBOOT_P10_CUSTOM_VERSION_VALUE \
		if BR2_HOSTBOOT_P10_CUSTOM_VERSION

config BR2_HOSTBOOT_P10_CONFIG_FILE
        string "Hostboot configuration file for compilation"
        default default
        help
            String used to define hw specific make config file

endif
```
