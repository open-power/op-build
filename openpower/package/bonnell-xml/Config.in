## openpower/package/hostboot-p11/Config.in
```kconfig
config BR2_PACKAGE_HOSTBOOT_P11
        bool "hostboot-p11"
        default y if (BR2_OPENPOWER_POWER11)
        select BR2_CPP
        help
            Project to build the Hostboot package for P11

if BR2_PACKAGE_HOSTBOOT_P11

choice
	prompt "P11 Hostboot version"
	default BR2_HOSTBOOT_P11_LATEST_VERSION

config BR2_HOSTBOOT_P11_LATEST_VERSION
	bool "Use latest Hostboot version"

config BR2_HOSTBOOT_P11_CUSTOM_VERSION
	bool "Use custom Hostboot version"

endchoice

config BR2_HOSTBOOT_P11_CUSTOM_VERSION_VALUE
	string "Hostboot P11 version"
	depends on BR2_HOSTBOOT_P11_CUSTOM_VERSION

config BR2_HOSTBOOT_P11_VERSION
	string
	default "4d0c0b4559778757c6b2b72ecb1598ec875114f6" if BR2_HOSTBOOT_P11_LATEST_VERSION
	default BR2_HOSTBOOT_P11_CUSTOM_VERSION_VALUE \
		if BR2_HOSTBOOT_P11_CUSTOM_VERSION

config BR2_HOSTBOOT_P11_CONFIG_FILE
        string "Hostboot configuration file for compilation"
        default default
        help
            String used to define hw specific make config file

endif
```

## openpower/package/hostboot-p8/Config.in
```kconfig
config BR2_PACKAGE_HOSTBOOT_P8
        bool "hostboot-p8"
        default y if (BR2_OPENPOWER_POWER8)
        select BR2_CPP
        help
            Project to build the hostboot firmware codebase

if BR2_PACKAGE_HOSTBOOT_P8

config BR2_HOSTBOOT_P8_CONFIG_FILE
        string "Hostboot configuration file for compilation"
        default default
        help
            String used to define hw specific make config file

config BR2_HOSTBOOT_P8_USE_ALTERNATE_GCC
		bool "use Alternate GCC to build hostboot-p8"
		default n
		select BR2_PACKAGE_ALTERNATE_GCC
		help
		  Select to enable using an alternate version of GCC
		  to build hostboot-p8.

endif
```

## openpower/package/hostboot-p9/Config.in
```kconfig
config BR2_PACKAGE_HOSTBOOT_P9
        bool "hostboot-p9"
        default y if (BR2_OPENPOWER_POWER9)
        select BR2_CPP
        help
            Project to build the hostboot firmware codebase

if BR2_PACKAGE_HOSTBOOT_P9
config BR2_PACKAGE_PROVIDES_HOSTBOOT
        default "hostboot-p9"
endif

config BR2_HOSTBOOT_P9_CONFIG_FILE
        string "Hostboot configuration file for compilation"
        default default
        help
            String used to define hw specific make config file
```

## openpower/package/hostboot/Config.in
```kconfig
config BR2_PACKAGE_HOSTBOOT
        bool "hostboot"
        default y if (BR2_OPENPOWER_POWER9)
        select BR2_CPP
        help
            Project to build the hostboot firmware codebase

if BR2_PACKAGE_HOSTBOOT

choice
	prompt "Hostboot version"
	default BR2_HOSTBOOT_LATEST_VERSION

config BR2_HOSTBOOT_LATEST_VERSION
	bool "Use latest Hostboot master"

config BR2_HOSTBOOT_CUSTOM_VERSION
	bool "Custom version"

endchoice

config BR2_HOSTBOOT_CUSTOM_VERSION_VALUE
	string "hostboot version"
	depends on BR2_HOSTBOOT_CUSTOM_VERSION

config BR2_HOSTBOOT_VERSION
	string
	default "68f042b6a8e3805d09b8b9b3be51c1a3dcc8f2fa" if BR2_HOSTBOOT_LATEST_VERSION
	default BR2_HOSTBOOT_CUSTOM_VERSION_VALUE \
		if BR2_HOSTBOOT_CUSTOM_VERSION

config BR2_HOSTBOOT_CONFIG_FILE
        string "Hostboot configuration file for compilation"
        default default
        help
            String used to define hw specific make config file


config BR2_HOSTBOOT_USE_ALTERNATE_GCC
		bool "use Alternate GCC to build hostboot"
		default n
		select BR2_PACKAGE_ALTERNATE_GCC
		help
		  Select to enable using an alternate version of GCC
		  to build hostboot.

endif
```

## openpower/package/ibm-fw-proprietary-p10/Config.in
```kconfig
config BR2_PACKAGE_IBM_FW_PROPRIETARY_P10
    bool "ibm-fw-proprietary-p10"
    default n
    help
      Project to bring in IBM's proprietary code/files.
```

## openpower/package/ima-catalog/Config.in
```kconfig
config BR2_PACKAGE_IMA_CATALOG
	bool "ima_catalog"
	default y if (BR2_OPENPOWER_PLATFORM)
	help
		Event Catalog for In Memory Accumulation(IMA) hardware

config BR2_IMA_CATALOG_DTS
	string "Catalog DTS file to select"
	help
		String used to define the CATALOG dts file to select

config BR2_IMA_CATALOG_FILENAME
	string "Name of Catalog Binary file"
	help
		String used to define name of the CATALOG binary image file
```

## openpower/package/libflash/Config.in
```kconfig
config BR2_PACKAGE_LIBFLASH
	bool "libflash"
	depends on BR2_PACKAGE_SKIBOOT
	help
	  Build libflash shared library

config BR2_PACKAGE_PFLASH
	bool "pflash"
	default y if BR2_PACKAGE_LIBFLASH
	help
	  Install pflash utility to target

config BR2_PACKAGE_OPAL_GARD
	bool "opal-gard"
	default y if BR2_PACKAGE_LIBFLASH
	help
	  Install opal-gard utility to target
```

## openpower/package/loadkeys/Config.in
```kconfig
config BR2_PACKAGE_LOADKEYS
	bool "loadkeys"
	select BR2_PACKAGE_GETTEXT if BR2_NEEDS_GETTEXT_IF_LOCALE
	select BR2_PACKAGE_CHECK
	# Uses fork()
	depends on BR2_USE_MMU
	help
	  Custom package to install just the 'loadkeys'
	  binary from the kbd package.

	  http://kernel.org/pub/linux/utils/kbd/
```

## openpower/package/machine-xml/Config.in
```kconfig
menu "Machine XML (MRW)"

config BR2_PACKAGE_MACHINE_XML
        bool "machine_xml"
        default y if (BR2_OPENPOWER_PLATFORM)
        select BR2_PACKAGE_COMMON_P8_XML if (BR2_OPENPOWER_POWER8)
        help

choice
	prompt "Machine XML location"

config BR2_OPENPOWER_MACHINE_XML_GITHUB_PROJECT
       bool "OpenPOWER Github project name"

config BR2_OPENPOWER_MACHINE_XML_CUSTOM_GIT
       bool "Custom URL of machine xml repository"

endchoice

config BR2_OPENPOWER_MACHINE_XML_FILTER_UNWANTED_ATTRIBUTES
       bool "Filter Unwanted Attributes"
       default y if (BR2_OPENPOWER_POWER9)
       default n

config BR2_OPENPOWER_MACHINE_XML_OPPOWERVM_ATTRIBUTES
       bool "OPPOWERVM Attributes/Target"
       default y if (BR2_OPENPOWER_POWER9)
       default n

config BR2_OPENPOWER_MACHINE_XML_TARGET_TYPES_OPENPOWER_XML
       bool "Include target_types_openpower.xml"
       default y if (BR2_OPENPOWER_POWER9)
       default n

config BR2_OPENPOWER_MACHINE_XML_CUSTOM_GIT_VALUE
	string "URL of machine xml repository"
	depends on BR2_OPENPOWER_MACHINE_XML_CUSTOM_GIT

config BR2_OPENPOWER_MACHINE_XML_GITHUB_PROJECT_VALUE
       string "The Github project name (e.g. palmetto-xml)"
       depends on BR2_OPENPOWER_MACHINE_XML_GITHUB_PROJECT

config BR2_OPENPOWER_MACHINE_XML_VERSION
       string "Version of Machine XML"

config BR2_OPENPOWER_MACHINE_XML_FILENAME
       string "Machine XML filename (e.g. habanero.xml)"

config BR2_OPENPOWER_SYSTEM_XML_FILENAME
        string "Targeting system xml filename"
        default ""
        help
            Defines the name of the system XML filename to be used when creating targeting binary image

config BR2_OPENPOWER_MRW_XML_FILENAME
        string "Targeting mrw xml filename"
        default ""
        help
            Defines the name of the mrw XML filename to be used when creating targeting binary image

config BR2_OPENPOWER_BIOS_XML_FILENAME
        string "BIOS metadata XML filename"
        default ""
        help
            Defines the name of the BIOS XML filename to parse when generating BIOS metadata

endmenu
```

## openpower/package/mlca_framework/Config.in
```kconfig
config BR2_PACKAGE_HOST_MLCA_FRAMEWORK
        bool "MLCA framework signing library"
        default y if (BR2_PACKAGE_SBE_ODYSSEY)
        help
            MLCA PQC library for signing OpenPOWER firmware images
```
