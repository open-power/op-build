## openpower/package/ppe42-binutils/Config.in
```kconfig
config BR2_PACKAGE_HOST_PPE42_BINUTILS
        bool "ppe42-binutils"
        select BR2_CPP
        help
            Project to build the PPE42 PORE binutils
```

## openpower/package/ppe42-gcc/Config.in
```kconfig
config BR2_PACKAGE_HOST_PPE42_GCC
        bool "ppe42-gcc"
        select BR2_PACKAGE_HAS_PPE42_TOOLCHAIN
        select BR2_PACKAGE_PPE42_BINUTILS
        select BR2_CPP
        help
            Project to build the PPE42 gcc

if BR2_PACKAGE_HOST_PPE42_GCC
config BR2_PACKAGE_PROVIDES_PPE42_TOOLCHAIN
        default "ppe42-gcc"
endif
```

## openpower/package/ppe42-toolchain-external/Config.in
```kconfig
config BR2_PACKAGE_PPE42_TOOLCHAIN_EXTERNAL
	bool "ppe42-toolchain-external"
	select BR2_PACKAGE_HAS_PPE42_TOOLCHAIN
	help
	  Use an external PPE42 toolchain

if BR2_PACKAGE_PPE42_TOOLCHAIN_EXTERNAL
config BR2_PACKAGE_PROVIDES_PPE42_TOOLCHAIN
	default "ppe42-toolchain-external"

config BR2_PPE42_TOOLCHAIN_EXTERNAL_PATH
	string "External PPE42 toolchain path"
	help
	  Pathname to where the external PPE42 toolchain is
	  installed. The compiler is expected to be fully
	  contained within the "sysroot/ppe42-toolchain"
	  directory
endif
```

## openpower/package/rainier-4u-xml/Config.in
```kconfig
menu "Rainier 4U XML (MRW)"

config BR2_PACKAGE_RAINIER_4U_XML
        bool "rainier_4u_xml"

if BR2_PACKAGE_RAINIER_4U_XML

choice
	prompt "Rainier 4U XML location"

config BR2_RAINIER_4U_XML_GITHUB_PROJECT
       bool "OpenPOWER Github project name"

config BR2_RAINIER_4U_XML_CUSTOM_GIT
       bool "Custom URL of Rainier 4U xml repository"

endchoice

config BR2_RAINIER_4U_XML_FILTER_UNWANTED_ATTRIBUTES
       bool "Filter Unwanted Attributes"
       default y

config BR2_RAINIER_4U_XML_OPPOWERVM_ATTRIBUTES
       bool "OPPOWERVM Attributes/Target"
       default y

config BR2_RAINIER_4U_XML_TARGET_TYPES_OPENPOWER_XML
       bool "Include target_types_openpower.xml"
       default y

config BR2_RAINIER_4U_XML_CUSTOM_GIT_VALUE
	string "URL of Rainier 4U xml repository"
	depends on BR2_RAINIER_4U_XML_CUSTOM_GIT

config BR2_RAINIER_4U_XML_GITHUB_PROJECT_VALUE
       string "The Github project name (e.g. rainier-4u-xml)"
       default "rainier-4u-xml"
       depends on BR2_RAINIER_4U_XML_GITHUB_PROJECT

config BR2_RAINIER_4U_XML_VERSION
       string "Version of Rainier 4U XML"

config BR2_RAINIER_4U_XML_FILENAME
       string "Rainier 4U XML filename (e.g. Rainier-4U-MRW.xml)"
       default "Rainier-4U-MRW.xml"
       help
           The name of the MRW XML file. Note that this file MUST
           come with the '.xml' prefix (all lowercase)

config BR2_RAINIER_4U_XML_SYSTEM_FILENAME
        string "Targeting Rainier 4U system xml filename"
        default ""
        help
            Defines the name of the system XML filename
            to be used when creating targeting binary image

config BR2_RAINIER_4U_XML_TARGETING_FILENAME
        string "Targeting Rainier 4U mrw xml filename"
        default ""
        help
            Defines the name of the mrw XML filename
            to be used when creating targeting binary image

config BR2_RAINIER_4U_XML_BIOS_FILENAME
        string "BIOS Rainier 4U metadata XML filename"
        default "Rainier-4U-MRW_bios.xml"
        help
            Defines the name of the BIOS XML filename
            to parse when generating BIOS metadata

config BR2_RAINIER_4U_XML_TARGETING_BIN_FILENAME
        string "Name of the openpower binary targeting file"
        default "Rainier-4U-MRW.targeting.bin"
        help
            String used to define name of openpower targeting binary file

config BR2_RAINIER_4U_XML_TARGETING_ECC_FILENAME
        string "Name of the openpower binary targeting ecc file"
        default "Rainier-4U-MRW.targeting.bin.ecc"
        help
            String used to define name of openpower
            targeting binary file, ecc protected

endif

endmenu
```

## openpower/package/romulus-xml/Config.in
```kconfig
config BR2_PACKAGE_ROMULUS_XML
        bool "romulus_xml"
        default y if (BR2_OPENPOWER_CONFIG_NAME = "romulus")
        help
            Utilities for building xml and the targeting binary image

config BR2_ROMULUS_SYSTEM_XML_FILENAME
        string "Romulus targeting system xml filename"
        default ""
        help
            Defines the name of the system XML filename to be used when creating targeting binary image

config BR2_ROMULUS_MRW_XML_FILENAME
        string "Romulus targeting mrw xml filename"
        default ""
        help
            Defines the name of the mrw XML filename to be used when creating targeting binary image

config BR2_ROMULUS_BIOS_XML_FILENAME
        string "Romulus BIOS metadata XML filename"
        default ""
        help
            Defines the name of the BIOS XML filename to parse when generating BIOS metadata
```

## openpower/package/sb-signing-framework/Config.in
```kconfig
config BR2_PACKAGE_HOST_SB_SIGNING_FRAMEWORK
        bool "OpenPOWER secureboot signing server interface"
        default y if BR2_OPENPOWER_PLATFORM && ((BR2_OPENPOWER_SECUREBOOT_SIGN_MODE = "production") || (BR2_OPENPOWER_SECUREBOOT_KEY_TRANSITION_TO_PROD) || (BR2_OPENPOWER_P10_SECUREBOOT_SIGN_MODE = "production") || (BR2_OPENPOWER_P10_SECUREBOOT_KEY_TRANSITION_TO_PROD) )
        help
            Client interface to signing server for signing OpenPOWER firmware images
```

## openpower/package/sb-signing-utils/Config.in
```kconfig
config BR2_PACKAGE_HOST_SB_SIGNING_UTILS
        bool "OpenPOWER secureboot signing utilities"
        default y if (BR2_OPENPOWER_PLATFORM)
        help
            Secureboot utilities for signing OpenPOWER firmware images
```

## openpower/package/sbe-odyssey/Config.in
```kconfig
config BR2_PACKAGE_SBE_ODYSSEY
    bool "sbe-odyssey"
    depends on (BR2_PACKAGE_OPENPOWER_PNOR_P10 || BR2_PACKAGE_OPENPOWER_PNOR_P11)
    select BR2_PACKAGE_HOST_PYTHON3
    select BR2_PACKAGE_HOST_PYTHON3_SSL
    select BR2_PACKAGE_HOST_PYTHON3_BZIP2
    select BR2_PACKAGE_OP_IMAGE_TOOLS
    help
        Odyssey SBE package.

choice
    prompt "SBE Odyssey version"
    default BR2_SBE_ODYSSEY_LATEST_VERSION

config BR2_SBE_ODYSSEY_LATEST_VERSION
    bool "Use latest SBE Odyssey main branch"

endchoice

config BR2_SBE_ODYSSEY_VERSION
    string
    default "b22297da6105d44d613d942090c6f5f560fd9d8c" if BR2_SBE_ODYSSEY_LATEST_VERSION
```

## openpower/package/sbe-p10/Config.in
```kconfig
config BR2_PACKAGE_SBE_P10
        bool "sbe-p10"
        default y if (BR2_OPENPOWER_PLATFORM && BR2_OPENPOWER_POWER10)
        select BR2_CPP
        depends on BR2_PACKAGE_HCODE_P10
        help
            Project to build the sbe firmware codebase for P10

if BR2_PACKAGE_SBE_P10

choice
	prompt "SBE version"
	default BR2_SBE_P10_LATEST_VERSION

config BR2_SBE_P10_LATEST_VERSION
	bool "Use latest SBE master"

config BR2_SBE_P10_CUSTOM_VERSION
	bool "Custom SBE version"

endchoice

config BR2_SBE_P10_CUSTOM_VERSION_VALUE
	string "SBE version"
	depends on BR2_SBE_P10_CUSTOM_VERSION

config BR2_SBE_P10_VERSION
	string
	default "a8d01f34d4d4680ecd3e285c4a6a64048b65d0ac" if BR2_SBE_P10_LATEST_VERSION
	default BR2_SBE_P10_CUSTOM_VERSION_VALUE \
		if BR2_SBE_P10_CUSTOM_VERSION

endif
```

## openpower/package/sbe-p11/Config.in
```kconfig
config BR2_PACKAGE_SBE_P11
        bool "sbe-p11"
        default y if (BR2_OPENPOWER_PLATFORM && BR2_OPENPOWER_POWER11)
        select BR2_CPP
        depends on BR2_PACKAGE_HCODE_P11
        help
            Project to build the sbe firmware codebase for P11

if BR2_PACKAGE_SBE_P11

choice
	prompt "SBE version"
	default BR2_SBE_P11_LATEST_VERSION

config BR2_SBE_P11_LATEST_VERSION
	bool "Use latest SBE master"

config BR2_SBE_P11_CUSTOM_VERSION
	bool "Custom SBE version"

endchoice

config BR2_SBE_P11_CUSTOM_VERSION_VALUE
	string "SBE version"
	depends on BR2_SBE_P11_CUSTOM_VERSION

config BR2_SBE_P11_VERSION
	string
	default "0495da6998c8cf299e2b953766cb7653b329d956" if BR2_SBE_P11_LATEST_VERSION
	default BR2_SBE_P11_CUSTOM_VERSION_VALUE \
		if BR2_SBE_P11_CUSTOM_VERSION

endif
```

## openpower/package/sbe-validation/Config.in
```kconfig
config BR2_PACKAGE_SBE_VALIDATION
        bool "sbe-validation"
        default y if (BR2_OPENPOWER_PLATFORM && BR2_OPENPOWER_POWER9)
        select BR2_CPP
        help
            Project to build the sbe validation codebase

if BR2_PACKAGE_SBE_VALIDATION

choice
	prompt "SBE_VALIDATION version"
	default BR2_SBE_VALIDATION_LATEST_VERSION

config BR2_SBE_VALIDATION_LATEST_VERSION
	bool "Use latest SBE_VALIDATION master"

config BR2_SBE_VALIDATION_CUSTOM_VERSION
	bool "Custom SBE_VALIDATION version"

endchoice

config BR2_SBE_VALIDATION_CUSTOM_VERSION_VALUE
	string "SBE_VALIDATION version"
	depends on BR2_SBE_VALIDATION_CUSTOM_VERSION

config BR2_SBE_VALIDATION_VERSION
	string
	default "687d78e4df0d97852e0c6704159cbdbdb4d4b4a3" if BR2_SBE_VALIDATION_LATEST_VERSION
	default BR2_SBE_VALIDATION_CUSTOM_VERSION_VALUE \
		if BR2_SBE_VALIDATION_CUSTOM_VERSION

endif
```

## openpower/package/sbe/Config.in
```kconfig
config BR2_PACKAGE_SBE
        bool "sbe"
        default y if (BR2_OPENPOWER_PLATFORM && BR2_OPENPOWER_POWER9)
        select BR2_CPP
        depends on BR2_PACKAGE_HCODE
        depends on BR2_PACKAGE_HAS_PPE42_TOOLCHAIN
        help
            Project to build the sbe firmware codebase

if BR2_PACKAGE_SBE

choice
	prompt "SBE version"
	default BR2_SBE_LATEST_VERSION

config BR2_SBE_LATEST_VERSION
	bool "Use latest SBE master"

config BR2_SBE_CUSTOM_VERSION
	bool "Custom SBE version"

endchoice

config BR2_SBE_CUSTOM_VERSION_VALUE
	string "SBE version"
	depends on BR2_SBE_CUSTOM_VERSION

config BR2_SBE_VERSION
	string
	default "d30bd9885ea2fb0c220222a9aab2c86e34d5daab" if BR2_SBE_LATEST_VERSION
	default BR2_SBE_CUSTOM_VERSION_VALUE \
		if BR2_SBE_CUSTOM_VERSION

endif
```

## openpower/package/skiboot/Config.in
```kconfig
menu "Skiboot"

config BR2_PACKAGE_SKIBOOT
	bool "skiboot"
	depends on BR2_powerpc64 || BR2_powerpc64le
        default y if (BR2_OPENPOWER_PLATFORM)
	help
	  Build skiboot POWER firmware

if BR2_PACKAGE_SKIBOOT

config BR2_PACKAGE_SKIBOOT_EMBED_PAYLOAD
	bool "Embed kernel payload in skiboot image"
	depends on BR2_LINUX_KERNEL_ZIMAGE_EPAPR

choice
	prompt "Skiboot version"
	default BR2_SKIBOOT_LATEST_VERSION

config BR2_SKIBOOT_LATEST_VERSION
	bool "Use skiboot stable"

config BR2_SKIBOOT_CUSTOM_VERSION
	bool "Custom version"

endchoice

config BR2_SKIBOOT_CUSTOM_VERSION_VALUE
	string "skiboot version"
	depends on BR2_SKIBOOT_CUSTOM_VERSION

config BR2_SKIBOOT_VERSION
	string
	default "v6.6-85-gabe4c4799" if BR2_SKIBOOT_LATEST_VERSION
	default BR2_SKIBOOT_CUSTOM_VERSION_VALUE \
		if BR2_SKIBOOT_CUSTOM_VERSION

config BR2_SKIBOOT_CUSTOM_GIT
	bool "Custom git repository"

config BR2_SKIBOOT_CUSTOM_REPO_URL
	string "URL of custom repository"
	depends on BR2_SKIBOOT_CUSTOM_GIT

config BR2_SKIBOOT_DEVICETREE
	bool "Build device trees"

endif

endmenu
```

## openpower/package/zaius-xml/Config.in
```kconfig
config BR2_PACKAGE_ZAIUS_XML
        bool "zaius_xml"
        default y if (BR2_OPENPOWER_CONFIG_NAME = "zaius")
        help
            Utilities for building xml and the targeting binary image

config BR2_ZAIUS_SYSTEM_XML_FILENAME
        string "Zaius targeting system xml filename"
        default ""
        help
            Defines the name of the system XML filename to be used when creating targeting binary image

config BR2_ZAIUS_MRW_XML_FILENAME
        string "Zaius targeting mrw xml filename"
        default ""
        help
            Defines the name of the mrw XML filename to be used when creating targeting binary image

config BR2_ZAIUS_BIOS_XML_FILENAME
        string "Zaius BIOS metadata XML filename"
        default ""
        help
            Defines the name of the BIOS XML filename to parse when generating BIOS metadata
```

## openpower/platform/Config.in
```kconfig
config BR2_OPENPOWER_PLATFORM
    bool "Enables only one openPower platform"
    default n
    depends on ((BR2_OPENPOWER_POWER9 || BR2_OPENPOWER_POWER10 || BR2_OPENPOWER_POWER11) && !(BR2_OPENPOWER_POWER9 && BR2_OPENPOWER_POWER10 && BR2_OPENPOWER_POWER11))

config BR2_OPENPOWER_POWER9
    bool "Enables the OpenPower p9 platform"
    default n
    depends on BR2_powerpc64 || BR2_powerpc64le

config BR2_OPENPOWER_POWER10
    bool "Enables the OpenPower p10 platform"
    default n
    depends on BR2_powerpc64 || BR2_powerpc64le

config BR2_OPENPOWER_POWER11
    bool "Enables the OpenPower p11 platform"
    default n
    depends on BR2_powerpc64 || BR2_powerpc64le
```

## openpower/toolchain/Config.in
```kconfig
menu "OpenPower Toolchain"

source "$BR2_EXTERNAL_OP_BUILD_PATH/toolchain/ppe42-toolchain/Config.in"

endmenu
```

## openpower/toolchain/p8-pore-toolchain/Config.in
```kconfig
config BR2_PACKAGE_HAS_P8_PORE_TOOLCHAIN
	bool

config BR2_PACKAGE_PROVIDES_P8_PORE_TOOLCHAIN
	depends on BR2_PACKAGE_HAS_P8_PORE_TOOLCHAIN
	string
```

## openpower/toolchain/ppe42-toolchain/Config.in
```kconfig
config BR2_PACKAGE_HAS_PPE42_TOOLCHAIN
	bool

config BR2_PACKAGE_PROVIDES_PPE42_TOOLCHAIN
	depends on BR2_PACKAGE_HAS_PPE42_TOOLCHAIN
	string
```
