## openpower/package/ekb-p11/Config.in
```kconfig
menu "ekb"

config BR2_PACKAGE_EKB_P11
        bool "ekb"
        default y if (BR2_OPENPOWER_POWER11)
        help
          To boot the server, the bmc application and hostboot will expect
          hardware functional details which are maintained in xml files by ekb.
          So, this packge is used to get all those xml files and pdata will
          consume those xml files to add hardware functional details into
          device tree.

if BR2_PACKAGE_EKB_P11

choice
    prompt "EKB version"
    default BR2_EKB_P11_LATEST_VERSION

config BR2_EKB_P11_LATEST_VERSION
    bool "Use latest EKB master"

config BR2_EKB_P11_CUSTOM_VERSION
    bool "Custom EKB version"

endchoice

config BR2_EKB_P11_CUSTOM_VERSION_VALUE
    string "EKB version"
    depends on BR2_EKB_P11_CUSTOM_VERSION

config BR2_EKB_P11_VERSION
    string
    default "74b214fcef7a67bd016549b5023bf1abdd7ad9af" if BR2_EKB_P11_LATEST_VERSION
    default BR2_EKB_P11_CUSTOM_VERSION_VALUE if BR2_EKB_P11_CUSTOM_VERSION
endif

endmenu
```
